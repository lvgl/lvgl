## tests/configs/builtin_heap.defconfig
```kconfig
CONFIG_LV_USE_BUILTIN_MALLOC=y
CONFIG_LV_USE_BUILTIN_STRING=y
CONFIG_LV_USE_BUILTIN_SPRINTF=y
CONFIG_LV_MEM_SIZE=33554432
```

## tests/configs/full.defconfig
```kconfig
# Enable as much of LVGL as possible, so that the test suite exercises the
# widest feature set.

CONFIG_LV_CACHE_DEF_SIZE=10485760
CONFIG_LV_DRAW_SW_SHADOW_CACHE_SIZE=8
# Increase the draw thread stack size to 64KB in order to run ThorVG
CONFIG_LV_DRAW_THREAD_STACK_SIZE=65536
CONFIG_LV_USE_DRAW_SW_COMPLEX_GRADIENTS=y
CONFIG_LV_USE_FLOAT=y
CONFIG_LV_USE_MATRIX=y

CONFIG_LV_LOG_LEVEL_TRACE=y
CONFIG_LV_LOG_PRINTF=y
CONFIG_LV_USE_ASSERT_STYLE=y
CONFIG_LV_USE_ASSERT_MEM_INTEGRITY=y
CONFIG_LV_USE_ASSERT_OBJ=y

CONFIG_LV_USE_PROFILER=y
CONFIG_LV_USE_PROFILER_BUILTIN=y
CONFIG_LV_USE_PROFILER_BUILTIN_POSIX=y
CONFIG_LV_USE_SYSMON=y
CONFIG_LV_USE_PERF_MONITOR=y
CONFIG_LV_USE_MONKEY=y

# Fonts
CONFIG_LV_FONT_MONTSERRAT_8=y
CONFIG_LV_FONT_MONTSERRAT_10=y
CONFIG_LV_FONT_MONTSERRAT_12=y
CONFIG_LV_FONT_MONTSERRAT_16=y
CONFIG_LV_FONT_MONTSERRAT_18=y
CONFIG_LV_FONT_MONTSERRAT_20=y
CONFIG_LV_FONT_MONTSERRAT_22=y
CONFIG_LV_FONT_MONTSERRAT_24=y
CONFIG_LV_FONT_MONTSERRAT_26=y
CONFIG_LV_FONT_MONTSERRAT_28=y
CONFIG_LV_FONT_MONTSERRAT_30=y
CONFIG_LV_FONT_MONTSERRAT_32=y
CONFIG_LV_FONT_MONTSERRAT_34=y
CONFIG_LV_FONT_MONTSERRAT_36=y
CONFIG_LV_FONT_MONTSERRAT_38=y
CONFIG_LV_FONT_MONTSERRAT_40=y
CONFIG_LV_FONT_MONTSERRAT_42=y
CONFIG_LV_FONT_MONTSERRAT_44=y
CONFIG_LV_FONT_MONTSERRAT_46=y
CONFIG_LV_FONT_MONTSERRAT_48=y
CONFIG_LV_FONT_MONTSERRAT_28_COMPRESSED=y
CONFIG_LV_FONT_DEJAVU_16_PERSIAN_HEBREW=y
CONFIG_LV_FONT_SOURCE_HAN_SANS_SC_14_CJK=y
CONFIG_LV_FONT_SOURCE_HAN_SANS_SC_16_CJK=y
CONFIG_LV_FONT_UNSCII_8=y
CONFIG_LV_FONT_UNSCII_16=y
CONFIG_LV_FONT_DEFAULT_MONTSERRAT_14=y
CONFIG_LV_FONT_FMT_TXT_LARGE=y
CONFIG_LV_USE_FONT_COMPRESSED=y
CONFIG_LV_USE_FONT_MANAGER=y
CONFIG_LV_USE_FREETYPE=y
# CONFIG_LV_FREETYPE_USE_LVGL_PORT is not set
CONFIG_LV_FREETYPE_CACHE_FT_GLYPH_CNT=64
CONFIG_LV_USE_TINY_TTF=y
CONFIG_LV_TINY_TTF_FILE_SUPPORT=y
CONFIG_LV_USE_IMGFONT=y

# Text
CONFIG_LV_USE_BIDI=y
CONFIG_LV_USE_ARABIC_PERSIAN_CHARS=y
CONFIG_LV_USE_TRANSLATION=y
CONFIG_LV_LABEL_TEXT_SELECTION=y

# Widgets and layouts
CONFIG_LV_USE_FLEX=y
CONFIG_LV_USE_GRID=y
CONFIG_LV_USE_GRIDNAV=y
CONFIG_LV_USE_FRAGMENT=y
CONFIG_LV_USE_OBSERVER=y
CONFIG_LV_USE_FILE_EXPLORER=y
CONFIG_LV_USE_IME_PINYIN=y
CONFIG_LV_USE_CALENDAR_CHINESE=y
CONFIG_LV_USE_GESTURE_RECOGNITION=y

# Object identification
CONFIG_LV_USE_OBJ_ID=y
CONFIG_LV_USE_OBJ_ID_BUILTIN=y
CONFIG_LV_OBJ_ID_AUTO_ASSIGN=y
CONFIG_LV_USE_OBJ_NAME=y

# File systems
CONFIG_LV_USE_FS_STDIO=y
CONFIG_LV_FS_STDIO_LETTER=65
CONFIG_LV_FS_STDIO_CACHE_SIZE=512
CONFIG_LV_USE_FS_MEMFS=y
CONFIG_LV_FS_MEMFS_LETTER=77
CONFIG_LV_FS_DEFAULT_DRIVER_LETTER=65

# Image and video decoders
CONFIG_LV_USE_RLE=y
CONFIG_LV_USE_LZ4=y
CONFIG_LV_USE_LZ4_INTERNAL=y
CONFIG_LV_USE_LODEPNG=y
CONFIG_LV_USE_LIBPNG=y
CONFIG_LV_USE_BMP=y
CONFIG_LV_USE_TJPGD=y
CONFIG_LV_USE_QOI=y
CONFIG_LV_USE_GIF=y
CONFIG_LV_USE_SNAPSHOT=y
CONFIG_LV_USE_QRCODE=y
CONFIG_LV_USE_BARCODE=y
CONFIG_LV_USE_LOTTIE=y

# Vector graphics
CONFIG_LV_USE_VECTOR_GRAPHIC=y
CONFIG_LV_USE_THORVG=y
CONFIG_LV_USE_THORVG_INTERNAL=y
CONFIG_LV_USE_SVG=y
CONFIG_LV_USE_SVG_ANIMATION=y
CONFIG_LV_USE_SVG_DEBUG=y

# Demos. Several test cases render them and compare against a reference image.
CONFIG_LV_USE_DEMO_WIDGETS=y
CONFIG_LV_USE_DEMO_KEYPAD_AND_ENCODER=y
CONFIG_LV_USE_DEMO_STRESS=y
CONFIG_LV_USE_DEMO_RENDER=y
CONFIG_LV_USE_DEMO_MUSIC=y
CONFIG_LV_USE_DEMO_BENCHMARK=y
CONFIG_LV_USE_DEMO_VECTOR_GRAPHIC=y

# Display controller drivers
CONFIG_LV_USE_GENERIC_MIPI=y
CONFIG_LV_USE_ILI9341=y
CONFIG_LV_USE_ST7735=y
CONFIG_LV_USE_ST7789=y
CONFIG_LV_USE_ST7796=y
CONFIG_LV_USE_FT81X=y
```

## tests/configs/nuttx.defconfig
```kconfig
# NuttX port

CONFIG_LV_USE_NUTTX=y
CONFIG_LV_USE_NUTTX_INDEPENDENT_IMAGE_HEAP=y
CONFIG_LV_NUTTX_DEFAULT_DRAW_BUF_USE_INDEPENDENT_IMAGE_HEAP=y
CONFIG_LV_USE_NUTTX_LIBUV=y
# CONFIG_LV_USE_NUTTX_CUSTOM_INIT is not set
CONFIG_LV_USE_NUTTX_LCD=y
CONFIG_LV_NUTTX_LCD_DOUBLE_BUFFER=y
CONFIG_LV_USE_NUTTX_TOUCHSCREEN=y
CONFIG_LV_NUTTX_TOUCHSCREEN_CURSOR_SIZE=20
CONFIG_LV_USE_NUTTX_MOUSE=y
CONFIG_LV_USE_NUTTX_MOUSE_MOVE_STEP=1
CONFIG_LV_USE_NUTTX_TRACE_FILE=y
CONFIG_LV_NUTTX_TRACE_FILE_PATH="/data/lvgl-trace.log"
```

## tests/configs/sdl.defconfig
```kconfig
# SDL simulator. This build test also covers the NuttX port, which has no
# dedicated CI target of its own.

CONFIG_LV_USE_SDL=y
CONFIG_LV_USE_DRAW_SDL=y
# CONFIG_LV_SDL_AUTO_BACKEND is not set
CONFIG_LV_SDL_BACKEND_SW=y

CONFIG_LV_USE_NUTTX=y
CONFIG_LV_USE_NUTTX_INDEPENDENT_IMAGE_HEAP=y
CONFIG_LV_NUTTX_DEFAULT_DRAW_BUF_USE_INDEPENDENT_IMAGE_HEAP=y
CONFIG_LV_USE_NUTTX_LIBUV=y
# CONFIG_LV_USE_NUTTX_CUSTOM_INIT is not set
CONFIG_LV_USE_NUTTX_LCD=y
CONFIG_LV_NUTTX_LCD_DOUBLE_BUFFER=y
CONFIG_LV_USE_NUTTX_TOUCHSCREEN=y
CONFIG_LV_NUTTX_TOUCHSCREEN_CURSOR_SIZE=20
CONFIG_LV_USE_NUTTX_MOUSE=y
CONFIG_LV_USE_NUTTX_MOUSE_MOVE_STEP=1
CONFIG_LV_USE_NUTTX_TRACE_FILE=y
CONFIG_LV_NUTTX_TRACE_FILE_PATH="/data/lvgl-trace.log"
```
