## zephyr/Kconfig.defaults
```kconfig
# Copyright (c) 2026 André Costa <andre_miguel_costa@hotmail.com>
# SPDX-License-Identifier: Apache-2.0

config LV_DPI_DEF
	default LV_Z_DPI_DEF if LV_Z_DPI_DEF != 0

config LV_DRAW_BUF_ALIGN
	default LV_Z_DRAW_BUF_ALIGN if LV_Z_DRAW_BUF_ALIGN != 0

choice LV_COLOR_FORMAT_DEFAULT
	default LV_COLOR_FORMAT_I1 if LV_Z_COLOR_FORMAT_I1
	default LV_COLOR_FORMAT_L8 if LV_Z_COLOR_FORMAT_L8
	default LV_COLOR_FORMAT_RGB565 if LV_Z_COLOR_FORMAT_RGB565
	default LV_COLOR_FORMAT_RGB565_SWAPPED if LV_Z_COLOR_FORMAT_RGB565_SWAPPED
	default LV_COLOR_FORMAT_RGB888 if LV_Z_COLOR_FORMAT_RGB888
	default LV_COLOR_FORMAT_XRGB8888 if LV_Z_COLOR_FORMAT_XRGB8888
	default LV_COLOR_FORMAT_ARGB8888 if LV_Z_COLOR_FORMAT_ARGB8888
endchoice

config LV_USE_DRAW_DMA2D
	default y if LV_Z_DRAW_DMA2D

config LV_USE_DRAW_DMA2D_INTERRUPT
	default y if LV_Z_DRAW_DMA2D_INTERRUPT

config LV_DRAW_DMA2D_HAL_INCLUDE
	default LV_Z_DRAW_DMA2D_HAL_INCLUDE if LV_Z_DRAW_DMA2D

config LV_USE_DRAW_DAVE2D
	default y if LV_Z_DRAW_DAVE2D

config LV_USE_DRAW_PXP
	default y if LV_Z_DRAW_PXP

config LV_USE_NEMA_GFX
	default y if LV_Z_USE_NEMA_GFX

config LV_NEMA_USE_CACHE
	default y if LV_Z_NEMA_USE_CACHE

config LV_NEMA_CACHE_HAL_INCLUDE
	default LV_Z_NEMA_CACHE_HAL_INCLUDE if LV_Z_NEMA_USE_CACHE

choice LV_USE_NEMA_LIB
	default LV_NEMA_LIB_M33_REVC if LV_Z_NEMA_LIB_M33_REVC
	default LV_NEMA_LIB_M33_NEMAPVG if LV_Z_NEMA_LIB_M33_NEMAPVG
	default LV_NEMA_LIB_M55 if LV_Z_NEMA_LIB_M55
	default LV_NEMA_LIB_M7 if LV_Z_NEMA_LIB_M7
endchoice

choice LV_USE_NEMA_HAL
	default LV_NEMA_HAL_CUSTOM if LV_Z_NEMA_HAL_CUSTOM
	default LV_NEMA_HAL_STM32 if LV_Z_NEMA_HAL_STM32
endchoice

config LV_NEMA_STM32_HAL_INCLUDE
	default LV_Z_NEMA_STM32_HAL_INCLUDE if LV_Z_NEMA_HAL_STM32

config LV_USE_NEMA_VG
	default y if LV_Z_USE_NEMA_VG

config LV_NEMA_GFX_MAX_RESX
	default LV_Z_NEMA_GFX_MAX_RESX if LV_Z_USE_NEMA_GFX

config LV_NEMA_GFX_MAX_RESY
	default LV_Z_NEMA_GFX_MAX_RESY if LV_Z_USE_NEMA_GFX
```
