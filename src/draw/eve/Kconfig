## src/draw/vg_lite/Kconfig
```kconfig
config LV_USE_DRAW_VG_LITE
	bool "VG-Lite renderer"
	default n
	select LV_USE_MATRIX
	select LV_DRAW_HAS_VECTOR_SUPPORT
	help
		Renders with a VG-Lite GPU. Requires a VG-Lite driver, or the VG-Lite simulator below.

if LV_USE_DRAW_VG_LITE

config LV_VG_LITE_USE_GPU_INIT
	bool "Custom external gpu_init() function"
	default n
	help
		Call an application-provided gpu_init() before the first use of the GPU.

config LV_VG_LITE_USE_ASSERT
	bool "Assertions"
	default n
	help
		Check internal VG-Lite state with LV_ASSERT(). Useful while debugging.

config LV_VG_LITE_FLUSH_MAX_COUNT
	int "Flush trigger threshold (draw tasks)"
	default 8
	help
		The GPU tries to batch this many draw tasks before flushing.

config LV_VG_LITE_USE_BOX_SHADOW
	bool "Simulate box shadow with a border"
	default y
	help
		Usually faster, but does not match the rendering quality of the SW renderer.

config LV_VG_LITE_GRAD_CACHE_CNT
	int "Gradient cache size (entries)"
	default 32
	help
		The memory usage of a single gradient:
			linear: 4K bytes.
			radial: radius * 4K bytes.

config LV_VG_LITE_STROKE_CACHE_CNT
	int "Stroke cache size (entries)"
	default 32

config LV_VG_LITE_BITMAP_FONT_CACHE_CNT
	int "Unaligned bitmap font cache size (entries)"
	default 256

config LV_VG_LITE_DISABLE_VLC_OP_CLOSE
	bool "Remove VLC_OP_CLOSE path instruction (Workaround for NXP)"
	default n

config LV_VG_LITE_DISABLE_LINEAR_GRADIENT_EXT
	bool "Disable linear gradient extension"
	default n
	help
		Needed with older VG-Lite drivers that do not implement the extension.

config LV_VG_LITE_DISABLE_BLIT_RECT_OFFSET
	bool "Disable blit rectangle offset"
	default n
	help
		Works around HW errors on some GPUs at the cost of extra blits.

config LV_VG_LITE_PATH_DUMP_MAX_LEN
	int "Maximum path dump length (points)"
	default 1000

config LV_USE_VG_LITE_DRIVER
	bool "Built-in VG-Lite driver"
	default n
	help
		Build the VG-Lite driver bundled with LVGL instead of linking a vendor-provided one.

	if LV_USE_VG_LITE_DRIVER
	# A choice because the include path needs unquoted tokens, which Kconfig
	# strings cannot emit.
	choice
		prompt "VG-Lite GPU (series and revision)"
		default LV_VG_LITE_GPU_GC255_0X40A

		config LV_VG_LITE_GPU_GC255_0X40A
			bool "GC255 (revision 0x40A)"
		config LV_VG_LITE_GPU_GC355_0X0_1215
			bool "GC355 (revision 0x0_1215)"
		config LV_VG_LITE_GPU_GC355_0X0_1216
			bool "GC355 (revision 0x0_1216)"
		config LV_VG_LITE_GPU_GC555_0X423
			bool "GC555 (revision 0x423)"
		config LV_VG_LITE_GPU_GC555_0X423_ECO
			bool "GC555 (revision 0x423 ECO)"
		config LV_VG_LITE_GPU_GCNANOULTRAV_0X1003
			bool "GCNanoUltraV (revision 0x1003)"
	endchoice

	config LV_VG_LITE_GPU
		int
		default 0 if LV_VG_LITE_GPU_GC255_0X40A
		default 1 if LV_VG_LITE_GPU_GC355_0X0_1215
		default 2 if LV_VG_LITE_GPU_GC355_0X0_1216
		default 3 if LV_VG_LITE_GPU_GC555_0X423
		default 4 if LV_VG_LITE_GPU_GC555_0X423_ECO
		default 5 if LV_VG_LITE_GPU_GCNANOULTRAV_0X1003

	config LV_VG_LITE_HAL_GPU_BASE_ADDRESS
		hex "GPU base address"
		default 0x40240000
	endif #LV_USE_VG_LITE_DRIVER

config LV_USE_VG_LITE_THORVG
	bool "VG-Lite simulator (ThorVG)"
	default n
	select LV_USE_THORVG
	help
		Simulate VG-Lite hardware with ThorVG for debugging and testing on a PC simulator.
		Requires the internal or an external ThorVG library.

if LV_USE_VG_LITE_THORVG

config LV_VG_LITE_THORVG_LVGL_BLEND_SUPPORT
	bool "LVGL blend modes"
	default n
	depends on LV_USE_VG_LITE_THORVG

config LV_VG_LITE_THORVG_YUV_SUPPORT
	bool "YUV color formats"
	default n

config LV_VG_LITE_THORVG_LINEAR_GRADIENT_EXT_SUPPORT
	bool "Linear gradient extension"
	default n

config LV_VG_LITE_THORVG_16PIXELS_ALIGN
	bool "16 pixel alignment"
	default y

config LV_VG_LITE_THORVG_BUF_ADDR_ALIGN
	int "Buffer address alignment (bytes)"
	default 64

config LV_VG_LITE_THORVG_THREAD_RENDER
	bool "Multi-threaded rendering"
	default n

endif #LV_USE_VG_LITE_THORVG
endif #LV_USE_DRAW_VG_LITE
```

## src/drivers/display/eve5/Kconfig
```kconfig
config LV_USE_EVE5
	bool "EVE5 display and touch"
	default n
	depends on LV_USE_DRAW_VRAM
	help
		Display and touch driver using EVE HAL and the EVE GPU allocator.
		Requires the VRAM residency module and external EVE HAL libraries.

if LV_USE_EVE5

config LV_USE_FS_EVE5_SDCARD
	bool "EVE5 SD card filesystem"
	default n
	help
		Access files on an SD card connected to the EVE controller.

config LV_USE_FS_EVE5_FLASH
	bool "EVE5 flash filesystem"
	default n
	help
		Access assets in flash connected to the EVE controller.

endif
```

## src/drivers/display/fb/Kconfig
```kconfig
config LV_USE_LINUX_FBDEV
	bool "Linux framebuffer (fbdev)"
	default n
	help
		Driver for /dev/fb

if LV_USE_LINUX_FBDEV

config LV_LINUX_FBDEV_BSD
	bool "BSD-flavored framebuffer device"
	default n

choice
	prompt "Render mode"
	default LV_LINUX_FBDEV_RENDER_MODE_PARTIAL

	config LV_LINUX_FBDEV_RENDER_MODE_PARTIAL
		bool "Partial mode"
		help
			Render the screen in smaller parts so the buffer(s) can be smaller than the display and save RAM.
			At least 1/10 of the screen size is recommended.

	config LV_LINUX_FBDEV_RENDER_MODE_DIRECT
		bool "Direct mode"
		help
			Render into the correct location of screen-sized buffer(s) so they always hold the whole image, and flush only the changed areas.
			With 2 buffers their content is kept in sync automatically and flush_cb only has to change the address.

	config LV_LINUX_FBDEV_RENDER_MODE_FULL
		bool "Full mode"
		help
			Always redraw the whole screen even if only one pixel has changed.
			With 2 buffers flush_cb only has to change the address.

endchoice

choice
	prompt "Framebuffer size"
	default LV_LINUX_FBDEV_SINGLE_BUFFER

	config LV_LINUX_FBDEV_SINGLE_BUFFER
		bool "One screen-sized buffer"

	config LV_LINUX_FBDEV_DOUBLE_BUFFER
		bool "Two screen-sized buffers"
		depends on !LV_LINUX_FBDEV_RENDER_MODE_PARTIAL

	config LV_LINUX_FBDEV_CUSTOM_BUFFER
		bool "Custom-sized buffer"
		depends on LV_LINUX_FBDEV_RENDER_MODE_PARTIAL

endchoice

config LV_LINUX_FBDEV_BUFFER_COUNT
	int
	default 0 if LV_LINUX_FBDEV_CUSTOM_BUFFER
	default 1 if LV_LINUX_FBDEV_SINGLE_BUFFER
	default 2 if LV_LINUX_FBDEV_DOUBLE_BUFFER

config LV_LINUX_FBDEV_BUFFER_SIZE
	int "Custom partial buffer size (rows)"
	depends on LV_LINUX_FBDEV_CUSTOM_BUFFER
	default 60

config LV_LINUX_FBDEV_MMAP
	bool "Framebuffer device supports mmap"
	default y
	help
		Access the framebuffer through mmap() instead of write() calls.

endif #LV_USE_LINUX_FBDEV
```

## src/drivers/display/ft81x/Kconfig
```kconfig
config LV_USE_FT81X
	bool "FT81X"
	default n
	help
		Driver for FT81X EVE graphics controllers connected over SPI.
```

## src/drivers/display/lovyan_gfx/Kconfig
```kconfig
config LV_USE_LOVYAN_GFX
	bool "LovyanGFX"
	default n
	help
		Display and touch driver built on the LovyanGFX C++ library, which must be available in the build.

if LV_USE_LOVYAN_GFX

config LV_LGFX_USER_INCLUDE
	string "Header for LovyanGFX user configuration"
	default "lv_lgfx_user.hpp"

endif #LV_USE_LOVYAN_GFX
```

## src/drivers/display/mipi/Kconfig
```kconfig
config LV_USE_GENERIC_MIPI
	bool "Generic MIPI"
	default n
	help
		Driver for LCD devices connected via SPI or parallel port.
		Use it if your LCD controller is not listed among the dedicated drivers below.

config LV_USE_ST7735
	bool "ST7735"
	default n
	select LV_USE_GENERIC_MIPI

config LV_USE_ST7789
	bool "ST7789"
	default n
	select LV_USE_GENERIC_MIPI

config LV_USE_ST7796
	bool "ST7796"
	default n
	select LV_USE_GENERIC_MIPI

config LV_USE_ILI9341
	bool "ILI9341"
	default n
	select LV_USE_GENERIC_MIPI

config LV_USE_NV3007
	bool "NV3007"
	default n
	select LV_USE_GENERIC_MIPI
```

## src/drivers/display/nxp_elcdif/Kconfig
```kconfig
config LV_USE_NXP_ELCDIF
	bool "NXP ELCDIF"
	default n
	help
		Create a display on an already initialized NXP ELCDIF LCD controller.
```

## src/drivers/display/renesas_glcdc/Kconfig
```kconfig
config LV_USE_RENESAS_GLCDC
	bool "Renesas GLCDC"
	default n
	help
		Create a display driven by the Renesas GLCDC peripheral.
```

## src/drivers/display/st_ltdc/Kconfig
```kconfig
config LV_USE_ST_LTDC
	bool "ST LTDC"
	default n
	help
		Create a display bound to a layer of the ST LTDC peripheral.

if LV_USE_ST_LTDC

config LV_ST_LTDC_USE_DMA2D_FLUSH
	bool "DMA2D flush for partial mode displays"
	default n
	depends on !LV_USE_DRAW_DMA2D
	help
		Flush partial mode LTDC displays with DMA2D, in parallel with rendering.
		Only available when the DMA2D renderer is disabled.

endif #LV_USE_ST_LTDC
```

## src/drivers/display/tft_espi/Kconfig
```kconfig
config LV_USE_TFT_ESPI
	bool "TFT_eSPI"
	default n
	help
		Display driver built on the TFT_eSPI Arduino library, which must be available in the build.
```

## src/drivers/evdev/Kconfig
```kconfig
config LV_USE_EVDEV
	bool "evdev"
	default n
	help
		Read touchscreen, mouse and keyboard input from Linux /dev/input event devices.
```

## src/drivers/libinput/Kconfig
```kconfig
config LV_USE_LIBINPUT
	bool "libinput"
	default n
	help
		Read pointer, touch and keyboard input through libinput, which must be available in the build.

if LV_USE_LIBINPUT

config LV_LIBINPUT_BSD
	bool "BSD variant of libinput"
	default n

config LV_LIBINPUT_XKB
	bool "Full keyboard support via XKB"
	default n
	help
		Map key events to characters with XKB layouts, so modifiers and non-US layouts work.
		Requires linking with -lxkbcommon.

if LV_LIBINPUT_XKB

config LV_LIBINPUT_XKB_RULES
	string "XKB rules"
	default ""
	help
		Run `setxkbmap -query` to find the right values for your keyboard.

config LV_LIBINPUT_XKB_MODEL
	string "XKB model"
	default "pc101"

config LV_LIBINPUT_XKB_LAYOUT
	string "XKB layout"
	default "us"

config LV_LIBINPUT_XKB_VARIANT
	string "XKB variant"
	default ""

config LV_LIBINPUT_XKB_OPTIONS_USE_DEFAULT
	bool "System default XKB options"
	default y
	help
	  Pass NULL for the XKB options so the system default applies (e.g. from the
	  XKB_DEFAULT_OPTIONS env var). Otherwise LV_LIBINPUT_XKB_OPTIONS is used.

config LV_LIBINPUT_XKB_OPTIONS
	string "XKB options"
	default ""
	depends on !LV_LIBINPUT_XKB_OPTIONS_USE_DEFAULT

endif # LV_LIBINPUT_XKB

endif #LV_USE_LIBINPUT
```
