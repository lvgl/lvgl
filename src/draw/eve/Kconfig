## src/draw/eve/Kconfig
```kconfig
config LV_USE_DRAW_EVE
	bool "EVE renderer"
	default n
	help
		Offload drawing to an external EVE (FT81X/BT81X) graphics controller over SPI.

if LV_USE_DRAW_EVE

config LV_DRAW_EVE_EVE_GENERATION
	int "EVE generation"
	default 4
	range 2 4
	help
		Generation of the connected controller: 2 = FT81x, 3 = BT815/BT816,
		4 = BT817/BT818. Higher generations expose more commands and registers.

config LV_DRAW_EVE_WRITE_BUFFER_SIZE
	int "SPI write buffer size (bytes)"
	default 2048
	help
		Bytes buffered before each SPI transmission. 0 disables buffering;
		values below 4 are treated as 0.

endif
```

## src/draw/eve5/Kconfig
```kconfig
config LV_USE_DRAW_EVE5
	bool "EVE5 renderer"
	default n
	depends on LV_USE_EVE5
	help
		Render through EVE HAL, including BT820 render targets. Requires the
		EVE5 display driver. Keeps images, fonts and layers resident in EVE
		memory through the VRAM residency module when it is enabled.
```

## src/draw/gigadevice/ipa/Kconfig
```kconfig
config LV_USE_DRAW_IPA
	bool "IPA renderer"
	default n
	help
		Accelerate rendering with the GD32 IPA peripheral.

if LV_USE_DRAW_IPA

config LV_DRAW_IPA_HAL_INCLUDE
	string "GD32 peripheral header"
	default "gd32h7xx.h"
	help
		Header that provides the IPA peripheral definitions for the target
		GD32 family. Use gd32h7xx.h for GD32H7 devices, or the corresponding
		device header for another supported GD32 family.

config LV_USE_DRAW_IPA_INTERRUPT
	bool "Transfer complete interrupt"
	default n
	depends on LV_OS_FREERTOS
	help
		Use FreeRTOS synchronization for IPA transfers.
		Call lv_draw_ipa_transfer_complete_interrupt_handler()
		from the IPA interrupt handler.

endif
```

## src/draw/nanovg/Kconfig
```kconfig
config LV_USE_DRAW_NANOVG
	bool "NanoVG renderer"
	default n
	select LV_USE_NANOVG
	select LV_USE_OPENGLES
	select LV_USE_MATRIX
	select LV_DRAW_HAS_VECTOR_SUPPORT
	select LV_DRAW_HAS_3D_SUPPORT
	help
		Draw with the NanoVG vector library on top of OpenGL / OpenGL ES shaders.

if LV_USE_DRAW_NANOVG

choice LV_NANOVG_BACKEND
	prompt "NanoVG OpenGL backend"
	default LV_NANOVG_BACKEND_GLES2
	help
		NanoVG shader flavor to compile. Must match the OpenGL context the
		display driver creates.

	config LV_NANOVG_BACKEND_GL2
		bool "OpenGL 2.0"
	config LV_NANOVG_BACKEND_GL3
		bool "OpenGL 3.0+"
	config LV_NANOVG_BACKEND_GLES2
		bool "OpenGL ES 2.0"
	config LV_NANOVG_BACKEND_GLES3
		bool "OpenGL ES 3.0+"
endchoice

config LV_NANOVG_BACKEND
	int
	default 1 if LV_NANOVG_BACKEND_GL2
	default 2 if LV_NANOVG_BACKEND_GL3
	default 3 if LV_NANOVG_BACKEND_GLES2
	default 4 if LV_NANOVG_BACKEND_GLES3

config LV_NANOVG_IMAGE_CACHE_CNT
	int "Image texture cache size (entries)"
	default 128
	help
		Number of decoded images kept as GPU textures.

config LV_NANOVG_LETTER_CACHE_CNT
	int "Letter cache size (entries)"
	default 512
	help
		Number of rendered glyphs kept for text drawing.

endif
```

## src/draw/nema_gfx/Kconfig
```kconfig
config LV_USE_NEMA_GFX
	bool "NemaGFX renderer"
	default n
	help
		Accelerate drawing with the Think Silicon (TSi) NemaGFX GPU library.

if LV_USE_NEMA_GFX

config LV_NEMA_USE_CACHE
	bool "Cache maintenance"
	default n
	help
		Clean and invalidate the CPU cache around draw buffers so the GPU sees
		coherent data. Needed on cores with a data cache.

config LV_NEMA_CACHE_HAL_INCLUDE
	string "Cache HAL header"
	default "stm32u5xx_hal.h"
	depends on LV_NEMA_USE_CACHE

choice LV_USE_NEMA_LIB
	prompt "NemaGFX static library"
	default LV_NEMA_LIB_NONE
	help
		Bundled NemaGFX library and headers to use, per target CPU core.
		None warns at build time and falls back to Cortex-M33 (Rev C).

	config LV_NEMA_LIB_NONE
		bool "None"
	config LV_NEMA_LIB_M33_REVC
		bool "Cortex-M33 (Rev C)"
	config LV_NEMA_LIB_M33_NEMAPVG
		bool "Cortex-M33 (NemaPVG)"
	config LV_NEMA_LIB_M55
		bool "Cortex-M55"
	config LV_NEMA_LIB_M7
		bool "Cortex-M7"
endchoice

config LV_USE_NEMA_LIB
	int
	default 0 if LV_NEMA_LIB_NONE
	default 1 if LV_NEMA_LIB_M33_REVC
	default 2 if LV_NEMA_LIB_M33_NEMAPVG
	default 3 if LV_NEMA_LIB_M55
	default 4 if LV_NEMA_LIB_M7

choice LV_USE_NEMA_HAL
	prompt "NemaGFX HAL"
	default LV_NEMA_HAL_CUSTOM
	help
		STM32 uses the HAL bundled with LVGL. Custom means the application
		provides the NemaGFX HAL (nema_hal.c) itself.

	config LV_NEMA_HAL_CUSTOM
		bool "Custom"
	config LV_NEMA_HAL_STM32
		bool "STM32"
endchoice

config LV_USE_NEMA_HAL
	int
	default 0 if LV_NEMA_HAL_CUSTOM
	default 1 if LV_NEMA_HAL_STM32

config LV_NEMA_STM32_HAL_INCLUDE
	string "STM32 HAL header"
	default "stm32u5xx_hal.h"
	depends on LV_NEMA_HAL_STM32

config LV_NEMA_USE_CUSTOM_INCLUDE
	bool "Custom attribute header"
	default n
	depends on LV_NEMA_HAL_STM32
	help
	  Include the header given by LV_NEMA_CUSTOM_INCLUDE to override
	  NemaGFX/STM32 HAL-specific macros such as
	  LV_NEMA_STM32_HAL_ATTRIBUTE_POOL_MEM.

config LV_NEMA_CUSTOM_INCLUDE
	string "Path to custom NemaGFX attribute header"
	default ""
	depends on LV_NEMA_USE_CUSTOM_INCLUDE
	help
	  Optional header to override NemaGFX/STM32 HAL-specific macros.

	  LV_NEMA_STM32_HAL_ATTRIBUTE_POOL_MEM
	    Attribute applied to the NemaGFX memory pool on STM32 targets.
	    Used to place the pool in a specific RAM region accessible by
	    the NemaGFX DMA.
	    e.g. __attribute__((section(".nema_pool")))

config LV_USE_NEMA_VG
	bool "NemaVG vector graphics"
	select LV_DRAW_HAS_VECTOR_SUPPORT
	default n
	help
		Draw vector graphics (lv_vector_dsc) with NemaVG on top of NemaGFX.

config LV_NEMA_GFX_MAX_RESX
	int "NemaVG max horizontal resolution (px)"
	default 800
	help
		Canvas width NemaVG is initialized for. With the vertical resolution it also
		sizes the NemaGFX memory pool on STM32 (RESX * RESY + 10KB).

config LV_NEMA_GFX_MAX_RESY
	int "NemaVG max vertical resolution (px)"
	default 600
	help
		Canvas height NemaVG is initialized for.

endif
```

## src/draw/nxp/g2d/Kconfig
```kconfig
config LV_USE_G2D
	bool "G2D (legacy, no effect) [DEPRECATED: use LV_USE_DRAW_G2D]"
	default n
	help
	  Deprecated and non-functional. Use LV_USE_DRAW_G2D instead.

config LV_USE_DRAW_G2D
	bool "G2D renderer"
	default n
	help
		Accelerate blends, fills and image blits with the NXP G2D API (i.MX 2D GPU).
		Requires the g2d library and its headers.

if LV_USE_DRAW_G2D

config LV_G2D_HASH_TABLE_SIZE
	int "Buffer hash table size (entries)"
	default 50
	help
		Maximum number of buffers mapped for the G2D draw unit, including frame
		buffers and assets. Drawing asserts once the table is full.

config LV_USE_G2D_DRAW_THREAD
	bool "Dedicated draw thread"
	depends on !LV_OS_NONE
	default y
	help
		Dispatch G2D operations from their own thread so the CPU can keep
		rendering in parallel. Needs an OS.

config LV_USE_G2D_ASSERT
	bool "Asserts"
	depends on LV_USE_DRAW_G2D
	default n
	help
		Check the status of every G2D call and assert on failure. Useful while
		bringing up a board.

endif
```

## src/draw/nxp/pxp/Kconfig
```kconfig
config LV_USE_PXP
	bool "PXP (legacy, no effect) [DEPRECATED: use LV_USE_DRAW_PXP]"
	default n
	help
	  Deprecated and non-functional. Use LV_USE_DRAW_PXP instead.

config LV_USE_DRAW_PXP
	bool "PXP renderer"
	default n
	help
		Accelerate blends, fills and transforms with the PXP (Pixel Pipeline)
		engine of NXP i.MX RT SoCs.

if LV_USE_DRAW_PXP

config LV_USE_ROTATE_PXP
	bool "Display rotation"
	default n
	help
		Rotate the rendered display buffer with the PXP instead of the CPU.

config LV_USE_PXP_DRAW_THREAD
	bool "Dedicated draw thread"
	depends on !LV_OS_NONE
	default y
	help
		Dispatch PXP operations from their own thread so the CPU can keep
		rendering in parallel. Needs an OS.

config LV_USE_PXP_ASSERT
	bool "Asserts"
	help
		Check the status of every PXP call and assert on failure. Useful while
		bringing up a board.

endif
```

## src/draw/opengles/Kconfig
```kconfig
config LV_USE_DRAW_OPENGLES
	bool "OpenGL ES renderer"
	default n
	select LV_USE_OPENGLES
	select LV_DRAW_HAS_3D_SUPPORT
	help
		Draw with OpenGL ES, keeping rendered widgets and images as GPU textures.

if LV_USE_DRAW_OPENGLES

config LV_DRAW_OPENGLES_TEXTURE_CACHE_COUNT
	int "Texture cache size (entries)"
	default 64
	help
		Number of textures kept in the cache. More entries mean fewer redraws
		but more GPU memory.

endif
```

## src/draw/renesas/dave2d/Kconfig
```kconfig
config LV_USE_DRAW_DAVE2D
	bool "Dave2D renderer"
	default n
	help
		Accelerate drawing with the Dave2D GPU found on Renesas RA platforms.
```

## src/draw/sdl/Kconfig
```kconfig
config LV_USE_DRAW_SDL
	bool "SDL renderer"
	select LV_USE_DRAW_SW
	select LV_DRAW_DISABLE_TILED_RENDERING
	default n
	help
		Render with the SDL renderer API, caching widgets and images as SDL textures.
```

## src/draw/sifli/Kconfig
```kconfig
config LV_USE_SIFLI_EPIC
	bool "SiFli EPIC renderer"
	default n
	select LV_USE_DRAW_SW
	help
		Accelerate blends, fills, images and text with the EPIC (Enhanced
		Pixel Image Compositor) engine of SiFli BF0 SoCs. Unsupported
		operations fall back to software rendering.

if LV_USE_SIFLI_EPIC

config LV_USE_SIFLI_EPIC_DRAW_THREAD
	bool "Draw thread"
	depends on !LV_OS_NONE
	default y
	help
		Dispatch EPIC operations from their own thread so the CPU can keep
		rendering in parallel.

config LV_USE_SIFLI_EPIC_ASSERT
	bool "Asserts"
	help
		Check the status of every EPIC call and assert on failure. Useful
		while bringing up a board.

endif
```

## src/draw/snapshot/Kconfig
```kconfig
config LV_USE_SNAPSHOT
	bool "Snapshot"
	default n
	help
		Render a widget and its children into an image buffer with lv_snapshot_take().
```

## src/draw/sw/Kconfig
```kconfig
config LV_USE_DRAW_SW
	bool "SW renderer"
	default y
	help
		Required to draw anything on the screen.

if LV_USE_DRAW_SW

menu "Supported color formats"

config LV_DRAW_SW_SUPPORT_RGB565
	bool "RGB565"
	default y

config LV_DRAW_SW_SUPPORT_RGB565_SWAPPED
	bool "RGB565 swapped"
	default y

config LV_DRAW_SW_SUPPORT_RGB565A8
	bool "RGB565A8"
	default y

config LV_DRAW_SW_SUPPORT_RGB888
	bool "RGB888"
	default y

config LV_DRAW_SW_SUPPORT_XRGB8888
	bool "XRGB8888"
	default y

config LV_DRAW_SW_SUPPORT_ARGB8888
	bool "ARGB8888"
	default y

config LV_DRAW_SW_SUPPORT_ARGB8888_PREMULTIPLIED
	bool "ARGB8888 premultiplied"
	default y

config LV_DRAW_SW_SUPPORT_L8
	bool "L8"
	default y

config LV_DRAW_SW_SUPPORT_AL88
	bool "AL88"
	default y

config LV_DRAW_SW_SUPPORT_A8
	bool "A8"
	default y

config LV_DRAW_SW_SUPPORT_I1
	bool "I1"
	default y

config LV_DRAW_SW_I1_LUM_THRESHOLD
	int "I1 luminance threshold"
	default 127
	range 0 254
	depends on LV_DRAW_SW_SUPPORT_I1
	help
		Pixels brighter than this luminance become active (set) when rendering to I1.

endmenu

config LV_DRAW_SW_DRAW_UNIT_CNT
	int "Number of draw units"
	default 1
	depends on !LV_OS_NONE
	help
		Number of threads used to render a frame in parallel

config LV_USE_DRAW_ARM2D_SYNC
	bool "Arm-2D acceleration (Cortex-M)"
	default n
	help
		Requires the Arm-2D library in your project and an include path for "arm_2d.h".

config LV_USE_NATIVE_HELIUM_ASM
	bool "Native Helium assembly"
	default n
	help
		Disable to let Arm-2D work on its own (for testing only).

config LV_DRAW_SW_COMPLEX
	bool "Complex draw engine"
	default y
	help
		Adds rounded corners, shadows, skewed lines and arcs.
		Without it only rectangles with gradients, images, texts and straight lines can be drawn.

config LV_GRADIENT_MAX_STOPS
	int "Maximum gradient stops"
	default 2
	help
		Each additional stop costs (sizeof(lv_color_t) + 1) bytes.

config LV_USE_DRAW_SW_COMPLEX_GRADIENTS
	bool "Complex gradients"
	default n
	
	help
		Adds linear gradients at an angle, plus radial and conical gradients.

config LV_DRAW_SW_SHADOW_CACHE_SIZE
	int "Shadow cache size"
	depends on LV_DRAW_SW_COMPLEX
	default 0
	help
		Maximum shadow size to buffer, where shadow size is `shadow_width + radius`.
		Costs this value squared in RAM; 0 disables caching.

config LV_DRAW_SW_CIRCLE_CACHE_SIZE
	int "Circle cache size"
	depends on LV_DRAW_SW_COMPLEX
	default 4
	help
		The circumference of a 1/4 circle is cached for anti-aliasing, costing
		radius * 4 bytes per circle. Set to 0 to disable caching.

choice LV_USE_DRAW_SW_ASM
	prompt "SW assembly optimization"
	default LV_DRAW_SW_ASM_NONE
	
	config LV_DRAW_SW_ASM_NONE
		bool "0: None"
	config LV_DRAW_SW_ASM_NEON
		bool "1: NEON"
	config LV_DRAW_SW_ASM_HELIUM
		bool "2: Helium"
	config LV_DRAW_SW_ASM_RISCV_V
		bool "3: RISC-V Vector"
	config LV_DRAW_SW_ASM_CUSTOM
		bool "255: Custom"
		select LV_DRAW_SW_ASM_USE_CUSTOM_INCLUDE
endchoice

config LV_USE_DRAW_SW_ASM
	int
	default 0 if LV_DRAW_SW_ASM_NONE
	default 1 if LV_DRAW_SW_ASM_NEON
	default 2 if LV_DRAW_SW_ASM_HELIUM
	default 3 if LV_DRAW_SW_ASM_RISCV_V
	default 255 if LV_DRAW_SW_ASM_CUSTOM

config LV_DRAW_SW_ASM_USE_CUSTOM_INCLUDE
	bool

config LV_DRAW_SW_ASM_CUSTOM_INCLUDE
	string "Custom assembly include file"
	default ""
	depends on LV_DRAW_SW_ASM_CUSTOM

endif #LV_USE_DRAW_SW
```
