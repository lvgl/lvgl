## src/indev/Kconfig
```kconfig
menu "Input Devices"

config LV_INDEV_DEF_SCROLL_LIMIT
	int "Scroll threshold (px)"
	range 0 255
	default 10
	help
		Distance the pointer needs to travel before scrolling starts.

config LV_INDEV_DEF_SCROLL_THROW
	int "Scroll throw slow-down (%)"
	range 1 100
	default 10
	help
		Slow-down applied after releasing a scroll. Greater value means faster slow-down.

config LV_INDEV_DEF_SCROLL_ELASTIC_FACTOR
	int "Elastic scroll slow-down factor"
	range 1 255
	default 4
	help
		Scrolling past the edge of a scrollable widget is slower by this factor.

config LV_INDEV_DEF_LONG_PRESS_TIME
	int "Long press time (ms)"
	range 0 65535
	default 400
	help
		Press time after which `LV_EVENT_LONG_PRESSED` is sent.

config LV_INDEV_DEF_LONG_PRESS_REP_TIME
	int "Long press repeat period (ms)"
	range 0 65535
	default 100
	help
		Time between `LV_EVENT_LONG_PRESSED_REPEAT` events.

config LV_INDEV_DEF_DOUBLE_CLICK_TIME
	int "Multi-click time (ms)"
	range 0 65535
	default 400
	help
		Max time between consecutive clicks to count as a double or triple click.

config LV_INDEV_DEF_GESTURE_LIMIT
	int "Gesture threshold (px)"
	range 0 255
	default 50
	help
		Distance the pointer needs to travel before a gesture is detected.

config LV_INDEV_DEF_GESTURE_MIN_VELOCITY
	int "Gesture minimum velocity (px)"
	range 0 255
	default 3
	help
		Minimum pointer velocity at release to report a swipe.

config LV_INDEV_DEF_ROTARY_SENSITIVITY
	int "Rotary sensitivity"
	range 1 65535
	default 256
	help
		The encoder diff is multiplied by this value and divided by 256.

config LV_USE_GRIDNAV
	bool "Grid navigation"
	default n
	help
		Move focus between a container's children with arrow keys, based on their position.

config LV_USE_GESTURE_RECOGNITION
	bool "Multi-touch gesture recognition"
	select LV_USE_FLOAT
	default n
	help
		Detect pinch and rotate gestures from multi-touch input. Requires float support.

if LV_USE_GESTURE_RECOGNITION

config LV_INDEV_DEF_GESTURE_PINCH_DOWN_THRESHOLD
	int "Pinch in threshold (%)"
	range 1 99
	default 75
	help
		Scale the fingers need to pinch down to before pinch events are sent.

config LV_INDEV_DEF_GESTURE_PINCH_UP_THRESHOLD
	int "Pinch out threshold (%)"
	range 101 1000
	default 150
	help
		Scale the fingers need to pinch up to before pinch events are sent.

config LV_INDEV_DEF_GESTURE_PINCH_MAX_INITIAL_SCALE
	int "Pinch maximum initial scale (%)"
	range 101 1000
	default 250
	help
		A pinch starting above this scale is discarded.
		Must be greater than the pinch out threshold.

config LV_INDEV_DEF_GESTURE_ROTATION_THRESHOLD
	int "Rotation threshold (mrad)"
	range 1 3141
	default 200
	help
		Angle the fingers need to rotate by before rotation events are sent.

endif #LV_USE_GESTURE_RECOGNITION

endmenu
```

## src/layouts/Kconfig
```kconfig
menu "Layouts"

config LV_USE_FLEX
	bool "Flex"
	default y
	help
		Arrange children in a row or column that wraps and grows, similar to Flexbox in CSS.

config LV_USE_GRID
	bool "Grid"
	default y
	help
		Arrange children in rows and columns, similar to Grid in CSS.
endmenu
```

## src/logging/Kconfig
```kconfig
menu "Logging"
config LV_USE_LOG
	bool "Logging"

if LV_USE_LOG

choice
	bool "Default log verbosity"
	default LV_LOG_LEVEL_WARN

	config LV_LOG_LEVEL_TRACE
		bool "Trace: detailed information about everything"
	config LV_LOG_LEVEL_INFO
		bool "Info: important events"
	config LV_LOG_LEVEL_WARN
		bool "Warn: something unwanted happened but caused no problem"
	config LV_LOG_LEVEL_ERROR
		bool "Error: critical issues where the system may fail"
	config LV_LOG_LEVEL_USER
		bool "User: only logs added by the user"
	config LV_LOG_LEVEL_NONE
		bool "None: nothing is logged"
endchoice

config LV_LOG_LEVEL
	int
	default 0 if LV_LOG_LEVEL_TRACE
	default 1 if LV_LOG_LEVEL_INFO
	default 2 if LV_LOG_LEVEL_WARN
	default 3 if LV_LOG_LEVEL_ERROR
	default 4 if LV_LOG_LEVEL_USER
	default 5 if LV_LOG_LEVEL_NONE

config LV_LOG_LEVEL_NUM
	int 
	default 5

config LV_LOG_PRINTF
	bool "Print the log with 'printf'"
	default n
	help
		If not set, the user needs to register a callback with lv_log_register_print_cb().

config LV_LOG_USE_TIMESTAMP
	bool "Add a timestamp to each log"
	default y

config LV_LOG_USE_FILE_LINE
	bool "Add the file name and line number to each log"
	default y

menu "Trace logs per module"

config LV_LOG_TRACE_MEM
	bool "Memory"
	default y

config LV_LOG_TRACE_TIMER
	bool "Timer"
	default y

config LV_LOG_TRACE_INDEV
	bool "Input devices"
	default y

config LV_LOG_TRACE_DISP_REFR
	bool "Display refresh"
	default y

config LV_LOG_TRACE_EVENT
	bool "Events"
	default y

config LV_LOG_TRACE_OBJ_CREATE
	bool "Widget creation"
	default y

config LV_LOG_TRACE_LAYOUT
	bool "Layout"
	default y

config LV_LOG_TRACE_ANIM
	bool "Animations"
	default y

config LV_LOG_TRACE_CACHE
	bool "Cache"
	default y

endmenu

endif
endmenu
```

## src/osal/Kconfig
```kconfig
menu "Operating System (OS)"
choice LV_USE_OS
	prompt "Operating system"
	default LV_OS_NONE

	config LV_OS_NONE
		bool "None"
	config LV_OS_PTHREAD
		bool "POSIX threads (pthread)"
		select LV_OS_USE_PTHREAD
	config LV_OS_FREERTOS
		bool "FreeRTOS"
		select LV_OS_USE_FREERTOS
	config LV_OS_CMSIS_RTOS2
		bool "CMSIS-RTOS2"
		select LV_OS_USE_CMSIS_RTOS2
	config LV_OS_RTTHREAD
		bool "RT-Thread"
		select LV_OS_USE_RTTHREAD
	config LV_OS_WINDOWS
		bool "Windows"
		select LV_OS_USE_WINDOWS
	config LV_OS_MQX
		bool "MQX"
		select LV_OS_USE_MQX
	config LV_OS_SDL2
		bool "SDL2"
		select LV_OS_USE_SDL2
	config LV_OS_CUSTOM
		bool "Custom"
		select LV_OS_USE_CUSTOM_INCLUDE
endchoice

config LV_USE_OS
	int
	default 0 if LV_OS_NONE
	default 1 if LV_OS_PTHREAD
	default 2 if LV_OS_FREERTOS
	default 3 if LV_OS_CMSIS_RTOS2
	default 4 if LV_OS_RTTHREAD
	default 5 if LV_OS_WINDOWS
	default 6 if LV_OS_MQX
	default 7 if LV_OS_SDL2
	default 255 if LV_OS_CUSTOM

config LV_OS_USE_PTHREAD
	bool

config LV_OS_USE_FREERTOS
	bool

config LV_OS_USE_CMSIS_RTOS2
	bool

config LV_OS_USE_RTTHREAD
	bool

config LV_OS_USE_WINDOWS
	bool

config LV_OS_USE_MQX
	bool

config LV_OS_USE_SDL2
	bool

config LV_OS_USE_CUSTOM_INCLUDE
	bool

config LV_OS_CUSTOM_INCLUDE
	string "Custom OS include header"
	default ""
	depends on LV_OS_CUSTOM

if LV_OS_FREERTOS
menu "FreeRTOS Configuration"

config LV_USE_FREERTOS_TASK_NOTIFY
	bool "Direct task notifications"
	default y
	help
		Synchronize with direct task notifications instead of an intermediary object such as a
		binary semaphore: 45% faster and less RAM, but only usable when a single task can be
		the recipient of the event.

config LV_OS_IDLE_PERCENT_CUSTOM
	bool "Custom idle percentage calculation"
	default n
	help
		Provide your own lv_os_get_idle_percent(). Useful on multi-core systems, where the
		default FreeRTOS implementation may not track idle time across all cores.
endmenu
endif #LV_OS_FREERTOS
endmenu
```

## src/others/Kconfig
```kconfig
menu "Others"
config LV_USE_FRAGMENT
	bool "Fragment"
	default n
	help
		Manage a widget subtree with its own lifecycle and back stack, similar to Android fragments.

endmenu
```

## src/stdlib/Kconfig
```kconfig
menu "Memory and Standard Library"

config LV_STDLIB_BUILTIN
	int
	default 0

config LV_STDLIB_CLIB
	int
	default 1

config LV_STDLIB_MICROPYTHON
	int
	default 2

config LV_STDLIB_RTTHREAD
	int
	default 3

config LV_STDLIB_CUSTOM
	int 
	default 255

choice
	prompt "Malloc functions source"
	default LV_USE_BUILTIN_MALLOC

config LV_USE_BUILTIN_MALLOC
	select LV_USE_TLSF
	bool "LVGL built-in"

config LV_USE_CLIB_MALLOC
	bool "C standard library (malloc/realloc/free)"

config LV_USE_MICROPYTHON_MALLOC
	bool "MicroPython"

config LV_USE_RTTHREAD_MALLOC
	bool "RT-Thread"

config LV_USE_CUSTOM_MALLOC
	bool "Custom (implemented externally)"

endchoice # "Malloc functions"

config LV_USE_STDLIB_MALLOC
	int
	default LV_STDLIB_BUILTIN 	if LV_USE_BUILTIN_MALLOC
	default LV_STDLIB_CLIB 		if LV_USE_CLIB_MALLOC
	default LV_STDLIB_MICROPYTHON 	if LV_USE_MICROPYTHON_MALLOC
	default LV_STDLIB_RTTHREAD 	if LV_USE_RTTHREAD_MALLOC
	default LV_STDLIB_CUSTOM 	if LV_USE_CUSTOM_MALLOC

choice
	prompt "String functions source"
	default LV_USE_BUILTIN_STRING

config LV_USE_BUILTIN_STRING
	bool "LVGL built-in"

config LV_USE_CLIB_STRING
	bool "C standard library (memcpy/memset/strlen/strcpy)"

config LV_USE_RTTHREAD_STRING
	bool "RT-Thread (rt_memcpy/rt_memset/rt_strlen/rt_strcpy)"

config LV_USE_CUSTOM_STRING
	bool "Custom (implemented externally)"

endchoice

config LV_USE_STDLIB_STRING
	int
	default LV_STDLIB_BUILTIN 	if LV_USE_BUILTIN_STRING
	default LV_STDLIB_CLIB 		if LV_USE_CLIB_STRING
	default LV_STDLIB_RTTHREAD 	if LV_USE_RTTHREAD_STRING
	default LV_STDLIB_CUSTOM 	if LV_USE_CUSTOM_STRING

choice
	prompt "Sprintf functions source"
	default LV_USE_BUILTIN_SPRINTF

config LV_USE_BUILTIN_SPRINTF
	bool "LVGL built-in"

config LV_USE_CLIB_SPRINTF
	bool "C standard library (vsnprintf)"

config LV_USE_RTTHREAD_SPRINTF
	bool "RT-Thread (rt_vsnprintf)"

config LV_USE_CUSTOM_SPRINTF
	bool "Custom (implemented externally)"

endchoice # "Sprintf functions"

config LV_USE_STDLIB_SPRINTF
	int
	default LV_STDLIB_BUILTIN 	if LV_USE_BUILTIN_SPRINTF
	default LV_STDLIB_CLIB 		if LV_USE_CLIB_SPRINTF
	default LV_STDLIB_RTTHREAD 	if LV_USE_RTTHREAD_SPRINTF
	default LV_STDLIB_CUSTOM 	if LV_USE_CUSTOM_SPRINTF

if LV_USE_BUILTIN_MALLOC

menu "Builtin Malloc Settings"

config LV_MEM_SIZE
	int "Memory size (bytes)"
	default 65536
	help
	  Size of the pool `lv_malloc()` allocates from. Needs to be at least 2kB (2048).

config LV_MEM_SIZE_KILOBYTES
	int "Memory size (KB) [DEPRECATED: use LV_MEM_SIZE]"
	default 0
	help
	  Deprecated. Use LV_MEM_SIZE (in bytes) instead.

config LV_MEM_POOL_EXPAND_SIZE_KILOBYTES
	int "Memory pool expand size (KB) [DEPRECATED: use LV_MEM_SIZE directly]"
	default 0
	help
	  Deprecated. Modify LV_MEM_SIZE (in bytes) directly instead.

config LV_MEM_ADR
	hex "Memory pool address"
	default 0x0
	help
	  Place the pool at a fixed address instead of allocating it as a normal array.
	  0: unused.
endmenu

endif #LV_USE_BUILTIN_MALLOC

# Emitted verbatim (unquoted) as the #include argument.
config LV_STDINT_INCLUDE
	string "Header for integer types (stdint)"
	default "stdint.h"

config LV_STDDEF_INCLUDE
	string "Header for standard definitions (stddef)"
	default "stddef.h"

config LV_STDBOOL_INCLUDE
	string "Header for boolean types (stdbool)"
	default "stdbool.h"

config LV_INTTYPES_INCLUDE
	string "Header for fixed-width integer format macros (inttypes)"
	default "inttypes.h"

config LV_LIMITS_INCLUDE
	string "Header for implementation limits (limits)"
	default "limits.h"

config LV_STDARG_INCLUDE
	string "Header for variadic argument handling (stdarg)"
	default "stdarg.h"

config LV_USE_TLSF
	bool
	default n
endmenu
```

## src/themes/Kconfig
```kconfig
menu "Themes"

config LV_USE_THEME_DEFAULT
	bool "Default theme"
	default y
	help
		Full-featured theme used by LVGL's demos and examples.

if LV_USE_THEME_DEFAULT
config LV_THEME_DEFAULT_DARK
	bool "Dark mode"
	default n

config LV_THEME_DEFAULT_GROW
	bool "Grow on press"
	default y

config LV_THEME_DEFAULT_TRANSITION_TIME
	int "Transition time (ms)"
	default 80

endif #LV_USE_THEME_DEFAULT

config LV_USE_THEME_SIMPLE
	bool "Simple theme"
	default y
	help
		Minimal styling, a good starting point for a custom theme.

config LV_USE_THEME_MONO
	bool "Monochrome theme"
	default y
	help
		Styling for 1-bit displays such as e-paper and dot-matrix panels.
endmenu
```
