## src/drivers/nuttx/Kconfig
```kconfig
config LV_USE_NUTTX
	bool "NuttX"
	default n
	help
		Display and input drivers for NuttX, including the /dev/fb framebuffer device.

if LV_USE_NUTTX

config LV_USE_NUTTX_INDEPENDENT_IMAGE_HEAP
	bool "Independent image heap"
	default n
	help
		Allocate cached image buffers from a separate NuttX heap to keep the main heap from fragmenting.

config LV_NUTTX_DEFAULT_DRAW_BUF_USE_INDEPENDENT_IMAGE_HEAP
	bool "Independent image heap for the default draw buffer"
	depends on LV_USE_NUTTX_INDEPENDENT_IMAGE_HEAP
	default n

config LV_USE_NUTTX_LIBUV
	bool "libuv event loop"
	default n
	help
		Drive the LVGL timer handler and the display/input timers from a libuv loop instead of the default timer loop.

config LV_USE_NUTTX_CUSTOM_INIT
	bool "Custom init API"
	default n
	help
		Skip the display and input device creation in lv_nuttx_init() so the application can set them up itself.

config LV_USE_NUTTX_LCD
	bool "LCD device"
	default n
	help
		Create the display on a NuttX LCD character device instead of the framebuffer device.

choice
	prompt "LCD buffer size"
	depends on LV_USE_NUTTX_LCD
	default LV_NUTTX_LCD_CUSTOM_BUFFER

	config LV_NUTTX_LCD_SINGLE_BUFFER
		bool "One screen-sized buffer"

	config LV_NUTTX_LCD_DOUBLE_BUFFER
		bool "Two screen-sized buffers"

	config LV_NUTTX_LCD_CUSTOM_BUFFER
		bool "Custom-sized buffer"

endchoice

config LV_NUTTX_LCD_BUFFER_COUNT
	int
	default 0 if LV_NUTTX_LCD_CUSTOM_BUFFER
	default 1 if LV_NUTTX_LCD_SINGLE_BUFFER
	default 2 if LV_NUTTX_LCD_DOUBLE_BUFFER

config LV_NUTTX_LCD_BUFFER_SIZE
	int "Custom partial buffer size (rows)"
	depends on LV_NUTTX_LCD_CUSTOM_BUFFER
	depends on LV_USE_NUTTX_LCD
	default 60
	

config LV_USE_NUTTX_TOUCHSCREEN
	bool "Touchscreen"
	default n

config LV_NUTTX_TOUCHSCREEN_CURSOR_SIZE
	int "Touchscreen cursor size (px)"
	depends on LV_USE_NUTTX_TOUCHSCREEN
	default 0
	help
		0 disables the cursor.

config LV_USE_NUTTX_MOUSE
	bool "Mouse"
	default n

config LV_USE_NUTTX_MOUSE_MOVE_STEP
	int "Mouse movement step (pixels)"
	depends on LV_USE_NUTTX_MOUSE
	range 1 10
	default 1

config LV_USE_NUTTX_TRACE_FILE
	bool "Profiler trace file"
	depends on LV_USE_PROFILER_BUILTIN
	default n
	help
		Write the built-in profiler output to a file instead of the console.

config LV_NUTTX_TRACE_FILE_PATH
	depends on LV_USE_NUTTX_TRACE_FILE
	string "Profiler trace file path"
	default "/data/lvgl-trace.log"


endif #LV_USE_NUTTX
```

## src/drivers/opengles/Kconfig
```kconfig
config LV_USE_OPENGLES
	bool "OpenGL ES"
	select LV_USE_MATRIX
	default n
	help
		Generic OpenGL ES display driver, for embedding LVGL in another application or driving it through GLFW/EGL.

if LV_USE_OPENGLES

config LV_USE_OPENGLES_DEBUG
	bool "Debug mode"
	default n
	help
		Check for an OpenGL error after every GL call and log it with the call site.


endif # LV_USE_OPENGLES

config LV_USE_EGL
	bool
	default n

# Promptless as it's not part of the public API
config LV_USE_OPENGLES_PBUFFER
	bool
	default n
	depends on LV_USE_DRAW_NANOVG
	select LV_USE_EGL
	select LV_USE_OPENGLES
	help
		Render on the GPU into an off-screen EGL pbuffer with no window system at
		all, and read the frame back into the display's draw buffer. For headless
		rendering, screenshot testing and server-side image generation.

config LV_USE_GLFW
	bool "GLFW"
	default n
	select LV_USE_OPENGLES
	depends on !LV_USE_EGL
	help
		Open a window on a PC desktop with GLFW and read mouse and keyboard input.
```

## src/drivers/qnx/Kconfig
```kconfig
config LV_USE_QNX
	bool "QNX"
	default n
	help
		Create a display on a QNX Screen window and read pointer and keyboard input.

if LV_USE_QNX

config LV_QNX_BUF_COUNT
	int "Number of screen-sized buffers"
	default 1

endif #LV_USE_QNX
```

## src/drivers/sdl/Kconfig
```kconfig
config LV_USE_SDL
	bool "SDL"
	default n
	help
		Open a window on a PC desktop with SDL2 and read mouse and keyboard input.

if LV_USE_SDL

config LV_SDL_INCLUDE_PATH
	string "SDL include path"
	default "SDL2/SDL.h"

config LV_SDL_AUTO_BACKEND
	bool "Auto-select the SDL backend (legacy)"
	default y
	help
	  Legacy behavior, slated for removal: EGL is inferred the legacy way
	  (LV_USE_OPENGLES with an OpenGL draw unit). Disable this and pick a backend
	  explicitly in the "Rendering backend" choice.

choice
	prompt "Rendering backend"
	default LV_SDL_BACKEND_SW
	depends on !LV_SDL_AUTO_BACKEND
	help
	  Select how the SDL driver presents rendered frames.

	config LV_SDL_BACKEND_SW
		bool "Software (SDL surface)"
		help
		  Render in software and upload via an SDL surface.

	config LV_SDL_BACKEND_TEXTURE
		bool "Cached SDL textures"
		select LV_USE_DRAW_SDL
		help
		  Render into cached SDL textures. Enables the SDL renderer.

	config LV_SDL_BACKEND_EGL
		bool "EGL (OpenGL ES, hardware-accelerated)"
		depends on LV_USE_DRAW_OPENGLES || LV_USE_DRAW_NANOVG
		select LV_SDL_USE_EGL
		help
		  Present frames through an EGL/OpenGL ES context.
		  Requires the OpenGL ES or NanoVG renderer.
endchoice

config LV_SDL_BACKEND
	int
	default 0 if LV_SDL_BACKEND_SW
	default 1 if LV_SDL_BACKEND_TEXTURE
	default 2 if LV_SDL_BACKEND_EGL

config LV_SDL_USE_EGL
	bool
	select LV_USE_EGL

choice
	prompt "Render mode"
	default LV_SDL_RENDER_MODE_DIRECT
	help
		Direct mode is recommended for best performance.

	config LV_SDL_RENDER_MODE_PARTIAL
		bool "Partial mode"
		help
			Render the screen in smaller parts so the buffer(s) can be smaller than the display and save RAM.

	config LV_SDL_RENDER_MODE_DIRECT
		bool "Direct mode"
		help
			Render into the correct location of screen-sized buffer(s) so they always hold the whole image, and flush only the changed areas.

	config LV_SDL_RENDER_MODE_FULL
		bool "Full mode"
		help
			Always redraw the whole screen even if only one pixel has changed.
endchoice

config LV_SDL_BUF_COUNT
	int "Number of screen-sized buffers"
	range 1 2
	default 1

choice
	prompt "SDL buffer count [DEPRECATED: use LV_SDL_BUF_COUNT]"
	optional

	config LV_SDL_SINGLE_BUFFER
		bool "One screen-sized buffer [DEPRECATED: set LV_SDL_BUF_COUNT to 1]"

	config LV_SDL_DOUBLE_BUFFER
		bool "Two screen-sized buffers [DEPRECATED: set LV_SDL_BUF_COUNT to 2]"
endchoice

config LV_SDL_ACCELERATED
	bool "Hardware acceleration"
	default y
	help
		Ask SDL for a GPU-backed renderer instead of a software one.

config LV_SDL_FULLSCREEN
	bool "Fullscreen"
	default n

config LV_SDL_DIRECT_EXIT
	bool "Exit when all windows are closed"
	default y

choice
	prompt "SDL mousewheel mode"
	default LV_SDL_MOUSEWHEEL_MODE_ENCODER

	config LV_SDL_MOUSEWHEEL_MODE_ENCODER
		bool "Encoder input device"

	config LV_SDL_MOUSEWHEEL_MODE_CROWN
		bool "Smart watch crown"
endchoice

config LV_SDL_MOUSEWHEEL_MODE
	int
	default 0 if LV_SDL_MOUSEWHEEL_MODE_ENCODER
	default 1 if LV_SDL_MOUSEWHEEL_MODE_CROWN


endif #LV_USE_SDL
```

## src/drivers/uefi/Kconfig
```kconfig
config LV_USE_UEFI
	bool "UEFI"
	default n
	help
		Display and input drivers for UEFI firmware, based on the Graphics Output, keyboard and pointer protocols.

if LV_USE_UEFI

config LV_USE_UEFI_INCLUDE
	string "Header wrapping the UEFI framework (EDK2, gnu-efi, ...)"
	default "myefi.h"

config LV_UEFI_USE_MEMORY_SERVICES
	bool "Memory services from the boot services table"
	default n
	help
		Allocate memory with the UEFI boot services instead of the C library.
		Only takes effect with the custom stdlib malloc implementation.

endif #LV_USE_UEFI
```

## src/drivers/wayland/Kconfig
```kconfig
config LV_USE_WAYLAND
	bool "Wayland"
	default n
	help
		Open a window on a Wayland compositor on Linux or BSD and read mouse, keyboard and touch input.

if LV_USE_WAYLAND

config LV_WAYLAND_DIRECT_EXIT
	bool "Exit when the last window closes"
	default y
	help
		LVGL is deinitialized before the application exits.

config LV_WAYLAND_USE_SHM
	bool "SHM (Shared Memory) Backend"
	default y
	depends on !LV_USE_DRAW_OPENGLES && !LV_USE_DRAW_NANOVG
	help
		Default backend, using wl_shm for double-buffered direct rendering.
		Compatible with all Wayland compositors; no special hardware required.
		Unavailable with the OpenGL ES and NanoVG renderers, which can only
		render into a GPU surface.

config LV_WAYLAND_USE_DMABUF
	bool "DMA-BUF Backend"
	depends on !LV_USE_DRAW_OPENGLES && !LV_USE_DRAW_NANOVG
	select LV_WAYLAND_USE_DMABUF_PROTOCOL
	help
		Presents software-rendered frames through linear DMA-BUFs that the
		compositor can scan out directly, saving its copy out of shared memory.
		Requires a compositor with zwp_linux_dmabuf_v1 and a gbm implementation
		able to allocate CPU-mappable buffers, plus libdrm and gbm (-ldrm -lgbm).
		Needs no GPU API: unavailable with the OpenGL ES and NanoVG renderers,
		which can only render into a GPU surface.

config LV_WAYLAND_USE_EGL
	bool "EGL (OpenGL ES, hardware-accelerated) Backend"
	default y if LV_USE_DRAW_OPENGLES || LV_USE_DRAW_NANOVG
	select LV_USE_EGL
	select LV_USE_OPENGLES
	help
		Hardware-accelerated rendering via OpenGL ES 2.0 and EGL, compatible
		with LVGL 3D/glTF rendering. Requires OpenGL ES 2.0 on the target
		hardware and linking with wayland-egl (-lwayland-egl).
		The only backend available with the OpenGL ES and NanoVG renderers.

config LV_WAYLAND_USE_G2D
	bool "G2D (NXP i.MX hardware accelerator)"
	depends on !LV_USE_DRAW_OPENGLES && !LV_USE_DRAW_NANOVG
	select LV_USE_DRAW_G2D
	select LV_WAYLAND_USE_DMABUF_PROTOCOL
	help
		Hardware-accelerated 2D rendering via NXP's G2D engine.
		Supports NXP i.MX6/i.MX8 platforms with G2D library installed.
		Unavailable with the OpenGL ES and NanoVG renderers, which can only
		render into a GPU surface.

config LV_WAYLAND_USE_DMABUF_PROTOCOL
	bool

endif # LV_USE_WAYLAND
```

## src/drivers/windows/Kconfig
```kconfig
config LV_USE_WINDOWS
	bool "Windows"
	depends on LV_OS_WINDOWS
	default n
	help
		Open a window with the Win32 API and read mouse, touch, keyboard and mousewheel input.
```

## src/drivers/x11/Kconfig
```kconfig
config LV_USE_X11
	bool "X11"
	default n
	help
		Open a window on an X11 desktop and read mouse and keyboard input.

if LV_USE_X11

config LV_X11_DOUBLE_BUFFER
	bool "Double buffering"
	default y
config LV_X11_DIRECT_EXIT
	bool "Exit when all windows are closed"
	default y
choice
	prompt "Render mode"
	default LV_X11_RENDER_MODE_PARTIAL

	config LV_X11_RENDER_MODE_PARTIAL
		bool "Partial mode"
		help
			Render the screen in smaller parts so the buffer(s) can be smaller than the display and save RAM.
			The driver uses buffer(s) of about 1/10 of the screen size.
	config LV_X11_RENDER_MODE_DIRECT
		bool "Direct mode"
		help
			Render into the correct location of screen-sized buffer(s) so they always hold the whole image, and flush only the changed areas.
			With 2 buffers their content is kept in sync automatically and flush_cb only has to change the address.
	config LV_X11_RENDER_MODE_FULL
		bool "Full mode"
		help
			Always redraw the whole screen even if only one pixel has changed.
			With 2 buffers flush_cb only has to change the address.
endchoice

endif #LV_USE_X11
```
