## src/debugging/Kconfig
```kconfig
menu "Debugging"
menu "System Monitoring"
	rsource "sysmon/Kconfig"
endmenu

menu "Profiler"
	rsource "profiler/Kconfig"
endmenu

menu "Test Utilities"
	rsource "test/Kconfig"

	config LV_USE_MONKEY
		bool "Monkey test"
		default n
		help
			Feed random input events to the UI for stress testing.
endmenu

menu "Debug Rendering"

config LV_USE_REFR_DEBUG
	bool "Redraw area overlay"
	help
		Draw random colored rectangles over the redrawn areas.

config LV_USE_LAYER_DEBUG
	bool "Layer type overlay"
	help
		Draw a red overlay over ARGB layers and a green overlay over RGB layers.

config LV_USE_PARALLEL_DRAW_DEBUG
	bool "Draw unit overlay"
	help
		Draw an overlay in a different color for each draw unit's tasks, with the
		draw unit's index number on a white background (black for layers).

config LV_USE_DRAW_COUNTERS
	bool "Draw counters"
	help
		Count the descriptors each draw unit draws and those no unit can draw, per draw type.

endmenu
endmenu
```

## src/draw/sifli/Kconfig
```kconfig
config LV_USE_SIFLI_EPIC
	bool "SiFli EPIC renderer"
	default n
	select LV_USE_DRAW_SW
	help
		Accelerate blends, fills, images and text with the EPIC (Enhanced
		Pixel Image Compositor) engine of SiFli BF0 SoCs. Unsupported
		operations fall back to software rendering.

if LV_USE_SIFLI_EPIC

config LV_USE_SIFLI_EPIC_ASSERT
	bool "Asserts"
	help
		Check the status of every EPIC call and assert on failure. Useful
		while bringing up a board.

endif
```

## src/drivers/display/gd_tli/Kconfig
```kconfig
config LV_USE_GD_TLI
	bool "GigaDevice TLI"
	default n
	help
		Create a display bound to a layer of the GigaDevice TLI peripheral.

if LV_USE_GD_TLI

config LV_DRIVER_TLI_HAL_INCLUDE
	string "GD32 peripheral header"
	default "gd32h7xx.h"
	help
		Header that provides the TLI and IPA register definitions for the target
		GD32 family. Use gd32h7xx.h for GD32H7 devices.

config LV_GD_TLI_DEFINE_IRQ_HANDLERS
	bool "Define TLI_IRQHandler in the driver"
	default y
	help
		Disable it to define TLI_IRQHandler in the application and call
		lv_gd_tli_irq_handler() from it.

config LV_GD_TLI_USE_IPA_FLUSH
	bool "IPA flush for partial mode displays"
	default n
	depends on !LV_USE_DRAW_IPA
	help
		Flush partial mode TLI displays with the IPA, in parallel with rendering.
		Only available when the IPA renderer is disabled.

config LV_GD_IPA_DEFINE_IRQ_HANDLERS
	bool "Define IPA_IRQHandler in the driver"
	default y
	depends on LV_GD_TLI_USE_IPA_FLUSH
	help
		Disable it to define IPA_IRQHandler in the application and call
		lv_gd_tli_ipa_irq_handler() from it.

endif #LV_USE_GD_TLI
```

## src/irqal/Kconfig
```kconfig
menu "IRQ Abstraction Layer (IRQ)"
# An IRQ provider defines lv_irq_attach_<source>() and lv_irq_detach_<source>()
# for the sources it serves, and turns on their LV_IRQ_PROVIDES_<SOURCE>. Where
# it comes from does not matter: picking a bundled one turns on the sources it
# can serve, and it serves those the device has.

choice LV_IRQ_PROVIDER
	prompt "IRQ provider"
	default LV_IRQ_PROVIDER_NONE

	config LV_IRQ_PROVIDER_NONE
		bool "None (or provided outside LVGL)"
		help
			Enable below the sources your own code provides.
	config LV_IRQ_PROVIDER_CMSIS
		bool "CMSIS (NVIC)"
		select LV_IRQ_PROVIDES_DMA2D
		select LV_IRQ_PROVIDES_PXP
		help
			Defines DMA2D_IRQHandler and PXP_IRQHandler for the enabled sources the
			device has, so the application must not define them too.
	config LV_IRQ_PROVIDER_ZEPHYR
		bool "Zephyr (device tree)"
		select LV_IRQ_PROVIDES_DMA2D
		select LV_IRQ_PROVIDES_PXP
		help
			Connects the interrupts of the enabled sources whose device-tree node
			(dma2d, pxp) exists.
	config LV_IRQ_PROVIDER_STM32
		bool "STM32 (HAL)"
		select LV_IRQ_PROVIDES_DMA2D
		select LV_IRQ_PROVIDES_NEMAGFX
		help
			Serves the interrupts the device has through the STM32 HAL, for
			CubeMX-style projects whose generated <PERIPH>_IRQHandler calls
			HAL_<PERIPH>_IRQHandler: DMA2D through the hdma2d handle's
			transfer-complete callback, the NemaGFX GPU2D through the hgpu2d
			handle's command-list-complete callback. A source is served when the
			device has it and its HAL module is enabled.
	config LV_IRQ_PROVIDER_CUSTOM
		bool "Custom"
		select LV_IRQ_USE_CUSTOM_INCLUDE
		help
			Your own provider. Enable below the sources it serves.
endchoice

config LV_IRQ_PROVIDER
	int
	default 0 if LV_IRQ_PROVIDER_NONE
	default 1 if LV_IRQ_PROVIDER_CMSIS
	default 2 if LV_IRQ_PROVIDER_ZEPHYR
	default 3 if LV_IRQ_PROVIDER_STM32
	default 255 if LV_IRQ_PROVIDER_CUSTOM

config LV_IRQ_USE_CUSTOM_INCLUDE
	bool

config LV_IRQ_CUSTOM_INCLUDE
	string "Custom IRQ provider header"
	default ""
	depends on LV_IRQ_PROVIDER_CUSTOM
	help
		Included by lv_conf_internal.h. Your build links lv_irq_attach_<source>()
		and lv_irq_detach_<source>() for each source enabled below.

config LV_IRQ_PROVIDES_DMA2D
	bool "Provides the DMA2D interrupt"
	help
		Declares lv_irq_attach_dma2d() and lv_irq_detach_dma2d(). LVGL's providers
		serve it only when the device has it (DMA2D_BASE in the device header, a
		dma2d device-tree node on Zephyr).

config LV_IRQ_PROVIDES_PXP
	bool "Provides the PXP interrupt"
	help
		Declares lv_irq_attach_pxp() and lv_irq_detach_pxp(). LVGL's providers
		serve it only when the device has it (PXP_BASE in the device header, a
		pxp device-tree node on Zephyr).

config LV_IRQ_PROVIDES_NEMAGFX
	bool "Provides the NemaGFX GPU2D completion"
	help
		Declares lv_irq_attach_nemagfx() and lv_irq_detach_nemagfx(). LVGL's STM32
		provider serves it only when the device has a GPU2D (GPU2D_BASE).

if LV_IRQ_PROVIDER_CMSIS

config LV_IRQ_CMSIS_USE_INCLUDE
	bool "Include a device header"
	help
		Include the device header that declares the IRQn_Type values
		(DMA2D_IRQn, PXP_IRQn, ...), the peripheral base addresses and the
		NVIC_* functions. Leave disabled if the build already makes them visible.

config LV_IRQ_CMSIS_INCLUDE
	string "Device header"
	default ""
	depends on LV_IRQ_CMSIS_USE_INCLUDE
	help
		For example "stm32h7xx.h".

config LV_IRQ_CMSIS_SET_NVIC_PRIORITY
	bool "Set the NVIC priority"
	help
		Enable on RTOS builds where the interrupt priority must sit at or below
		the kernel's syscall interrupt priority ceiling, so the ISR may call the
		kernel's ...FromISR APIs (lv_thread_sync_signal_isr uses one). Leave
		disabled on bare metal, where the reset-default priority is fine.

config LV_IRQ_CMSIS_NVIC_PRIORITY
	int "NVIC priority value"
	default 255
	depends on LV_IRQ_CMSIS_SET_NVIC_PRIORITY
	help
		The value passed to NVIC_SetPriority. 255 maps to the lowest preemption
		priority whatever __NVIC_PRIO_BITS is: always safe for ...FromISR calls,
		at the cost of latency. Under FreeRTOS the best latency is
		configLIBRARY_MAX_SYSCALL_INTERRUPT_PRIORITY + 1 (a hand-written lv_conf.h
		may write it symbolically; Kconfig takes a literal number).

endif

if LV_IRQ_PROVIDER_STM32

config LV_IRQ_STM32_HAL_INCLUDE
	string "STM32 HAL header"
	default "stm32u5xx_hal.h"
	help
		The family's HAL header, e.g. "stm32h7xx_hal.h".

endif

endmenu
```
