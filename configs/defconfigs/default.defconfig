## configs/defconfigs/empty.defconfig
```kconfig
# CONFIG_LV_USE_THEME_DEFAULT is not set
# CONFIG_LV_USE_THEME_SIMPLE is not set
# CONFIG_LV_USE_THEME_MONO is not set
# CONFIG_LV_USE_FLEX is not set
# CONFIG_LV_USE_GRID is not set
CONFIG_LV_TXT_ENC_ASCII=y
# CONFIG_LV_FONT_MONTSERRAT_14 is not set
CONFIG_LV_FONT_DEFAULT_UNSCII_8=y
# CONFIG_LV_WIDGETS_HAS_DEFAULT_VALUE is not set
# CONFIG_LV_USE_ANIMIMG is not set
# CONFIG_LV_USE_ARC is not set
# CONFIG_LV_USE_ARCLABEL is not set
# CONFIG_LV_USE_BAR is not set
# CONFIG_LV_USE_BUTTON is not set
# CONFIG_LV_USE_BUTTONMATRIX is not set
# CONFIG_LV_USE_CALENDAR is not set
# CONFIG_LV_USE_CANVAS is not set
# CONFIG_LV_USE_CHART is not set
# CONFIG_LV_USE_CHECKBOX is not set
# CONFIG_LV_USE_DROPDOWN is not set
# CONFIG_LV_USE_IMAGE is not set
# CONFIG_LV_USE_IMAGEBUTTON is not set
# CONFIG_LV_USE_KEYBOARD is not set
# CONFIG_LV_USE_LABEL is not set
# CONFIG_LV_USE_LED is not set
# CONFIG_LV_USE_LINE is not set
# CONFIG_LV_USE_LIST is not set
# CONFIG_LV_USE_MENU is not set
# CONFIG_LV_USE_MSGBOX is not set
# CONFIG_LV_USE_ROLLER is not set
# CONFIG_LV_USE_SCALE is not set
# CONFIG_LV_USE_SLIDER is not set
# CONFIG_LV_USE_SPAN is not set
# CONFIG_LV_USE_SPINBOX is not set
# CONFIG_LV_USE_SPINNER is not set
# CONFIG_LV_USE_SWITCH is not set
# CONFIG_LV_USE_TEXTAREA is not set
# CONFIG_LV_USE_TABLE is not set
# CONFIG_LV_USE_TABVIEW is not set
# CONFIG_LV_USE_TILEVIEW is not set
# CONFIG_LV_USE_WIN is not set
# CONFIG_LV_BUILD_EXAMPLES is not set
# CONFIG_LV_BUILD_DEMOS is not set
```

## configs/sdl2-3d_defconfig
```kconfig
CONFIG_LV_COLOR_DEPTH_32=y
CONFIG_LV_USE_CLIB_MALLOC=y
CONFIG_LV_USE_CLIB_STRING=y
CONFIG_LV_USE_CLIB_SPRINTF=y
CONFIG_LV_DEF_REFR_PERIOD=16
CONFIG_LV_DRAW_TRANSFORM_USE_MATRIX=y
CONFIG_LV_DRAW_THREAD_STACK_SIZE=65536
# CONFIG_LV_USE_DRAW_SW is not set
CONFIG_LV_USE_VECTOR_GRAPHIC=y
CONFIG_LV_USE_DRAW_NANOVG=y
CONFIG_LV_FONT_MONTSERRAT_8=y
CONFIG_LV_FONT_MONTSERRAT_10=y
CONFIG_LV_FONT_MONTSERRAT_12=y
CONFIG_LV_FONT_MONTSERRAT_16=y
CONFIG_LV_FONT_MONTSERRAT_18=y
CONFIG_LV_FONT_MONTSERRAT_20=y
CONFIG_LV_FONT_MONTSERRAT_22=y
CONFIG_LV_FONT_MONTSERRAT_24=y
CONFIG_LV_FONT_MONTSERRAT_26=y
CONFIG_LV_FONT_MONTSERRAT_28=y
CONFIG_LV_FONT_MONTSERRAT_30=y
CONFIG_LV_FONT_MONTSERRAT_32=y
CONFIG_LV_FONT_MONTSERRAT_34=y
CONFIG_LV_FONT_MONTSERRAT_36=y
CONFIG_LV_FONT_MONTSERRAT_38=y
CONFIG_LV_FONT_MONTSERRAT_40=y
CONFIG_LV_FONT_MONTSERRAT_42=y
CONFIG_LV_FONT_MONTSERRAT_44=y
CONFIG_LV_FONT_MONTSERRAT_46=y
CONFIG_LV_FONT_MONTSERRAT_48=y
CONFIG_LV_FONT_MONTSERRAT_28_COMPRESSED=y
CONFIG_LV_FONT_DEJAVU_16_PERSIAN_HEBREW=y
CONFIG_LV_FONT_SOURCE_HAN_SANS_SC_14_CJK=y
CONFIG_LV_FONT_SOURCE_HAN_SANS_SC_16_CJK=y
CONFIG_LV_FONT_UNSCII_8=y
CONFIG_LV_FONT_UNSCII_16=y
CONFIG_LV_FS_DEFAULT_DRIVER_LETTER=65
CONFIG_LV_USE_FS_STDIO=y
CONFIG_LV_FS_STDIO_LETTER=65
CONFIG_LV_FS_STDIO_CACHE_SIZE=1024
CONFIG_LV_USE_LODEPNG=y
CONFIG_LV_USE_LIBPNG=y
CONFIG_LV_USE_BMP=y
CONFIG_LV_USE_TJPGD=y
CONFIG_LV_USE_LIBJPEG_TURBO=y
CONFIG_LV_USE_LIBWEBP=y
CONFIG_LV_USE_GIF=y
CONFIG_LV_GIF_CACHE_DECODE_DATA=y
CONFIG_LV_BIN_DECODER_RAM_LOAD=y
CONFIG_LV_USE_SVG=y
CONFIG_LV_USE_SVG_ANIMATION=y
CONFIG_LV_USE_RLE=y
CONFIG_LV_USE_QRCODE=y
CONFIG_LV_USE_BARCODE=y
CONFIG_LV_USE_FREETYPE=y
CONFIG_LV_USE_TINY_TTF=y
CONFIG_LV_TINY_TTF_FILE_SUPPORT=y
CONFIG_LV_USE_NANOVG=y
CONFIG_LV_USE_LZ4=y
CONFIG_LV_USE_TRANSLATION=y
CONFIG_LV_USE_SDL=y
CONFIG_LV_SDL_DOUBLE_BUFFER=y
CONFIG_LV_USE_OPENGLES=y
CONFIG_LV_USE_THORVG=n
# CONFIG_LV_BUILD_EXAMPLES is not set
# CONFIG_LV_BUILD_DEMOS is not set
```

## demos/Kconfig
```kconfig
menu "Demos"
config LV_BUILD_DEMOS
	bool "Build demos"
	default y
	help
		Build the demos

if LV_BUILD_DEMOS

rsource "benchmark/Kconfig"
rsource "gltf/Kconfig"
rsource "keypad_encoder/Kconfig"
rsource "music/Kconfig"
rsource "render/Kconfig"
rsource "stress/Kconfig"
rsource "vector_graphic/Kconfig"
rsource "widgets/Kconfig"

	config LV_USE_DEMO_FLEX_LAYOUT
		bool "Flex layout previewer"
		default n
	config LV_USE_DEMO_MULTILANG
		bool "multi-language demo"
		default n

	config LV_USE_DEMO_SMARTWATCH
		bool "Smartwatch demo"

	config LV_USE_DEMO_EBIKE
		bool "Ebike demo"

	config LV_DEMO_EBIKE_PORTRAIT
		bool "Ebike portrait layout"
		depends on LV_USE_DEMO_EBIKE
		default n

	config LV_USE_DEMO_HIGH_RES
		bool "High resolution demo"
endif
endmenu #"Demos"
```

## env_support/kconfig/Kconfig.compiler
```kconfig
menu "Compiler Settings"
config LV_BIG_ENDIAN_SYSTEM
	bool "For big endian systems set to 1"
	help
		For big endian systems set to 1

config LV_ATTRIBUTE_USE_CUSTOM_INCLUDE
	bool "Include a custom attributes header"
	default n
	help
	  Include the header given by LV_ATTRIBUTE_CUSTOM_INCLUDE to override the
	  LV_ATTRIBUTE_* macros for your platform.

config LV_ATTRIBUTE_CUSTOM_INCLUDE
	string "Path to custom attributes header"
	default ""
	depends on LV_ATTRIBUTE_USE_CUSTOM_INCLUDE
	help
	  Optional header to override LV_ATTRIBUTE_* macros for your platform.
	  Leave empty to use defaults (all expand to nothing).

	  Create a header file and set this to its path, e.g. "my_lv_attr.h".
	  The following macros can be defined in it:

	  LV_ATTRIBUTE_MEM_ALIGN
	    Where memory needs to be aligned (e.g. with -Os, data may not be
	    aligned to the required boundary by default).
	    e.g. __attribute__((aligned(4)))

	  LV_ATTRIBUTE_TICK_INC
	    Applied to lv_tick_inc(). Often called from a timer ISR, so fast
	    memory placement can reduce latency.
	    e.g. __attribute__((section(".itcm"))) or __ramfunc (IAR)

	  LV_ATTRIBUTE_TIMER_HANDLER
	    Applied to lv_timer_handler().
	    e.g. __attribute__((section(".itcm")))

	  LV_ATTRIBUTE_FLUSH_READY
	    Applied to lv_display_flush_ready(). Often called from a DMA or
	    display ISR.
	    e.g. __attribute__((section(".itcm")))

	  LV_ATTRIBUTE_SYNC_READY
	    Applied to lv_display_sync_ready(). Similar to FLUSH_READY, useful
	    when called from an ISR context.
	    e.g. __attribute__((section(".itcm")))

	  LV_ATTRIBUTE_LARGE_CONST
	    Applied to large read-only arrays such as font bitmaps. Use to place
	    them in a specific flash region or external memory.
	    e.g. __attribute__((section(".ext_flash")))

	  LV_ATTRIBUTE_LARGE_RAM_ARRAY
	    Applied to large arrays allocated in RAM.
	    e.g. __attribute__((section(".ext_ram")))

	  LV_ATTRIBUTE_FAST_MEM
	    Applied to performance-critical functions to place them in faster
	    memory such as ITCM or SRAM.
	    e.g. __attribute__((section(".itcm"))) or __ramfunc (IAR)

	  LV_ATTRIBUTE_EXTERN_DATA
	    Prefix for all global extern data declarations. Useful for placing
	    shared data in a named section or applying export attributes.
	    e.g. __attribute__((section(".shared_mem")))

	  LV_EXPORT_CONST_INT(int_value)
	    Exports an integer constant to a language binding API such as
	    MicroPython. Called for all constants in the form LV_<CONST>.
	    Leave undefined if not using a binding.
	    e.g. mp_rom_map_elem_t entry = {MP_ROM_QSTR(MP_QSTR_##int_value), MP_ROM_INT(int_value)}

endmenu #"Compiler Settings"
```

## src/drivers/Kconfig
```kconfig
menu "Drivers"
rsource "display/drm/Kconfig"
rsource "display/fb/Kconfig"
rsource "display/ft81x/Kconfig"
rsource "display/lovyan_gfx/Kconfig"
rsource "display/mipi/Kconfig"
rsource "display/nxp_elcdif/Kconfig"
rsource "display/renesas_glcdc/Kconfig"
rsource "display/st_ltdc/Kconfig"
rsource "display/tft_espi/Kconfig"
rsource "evdev/Kconfig"
rsource "libinput/Kconfig"
rsource "nuttx/Kconfig"
rsource "opengles/Kconfig"
rsource "qnx/Kconfig"
rsource "sdl/Kconfig"
rsource "uefi/Kconfig"
rsource "wayland/Kconfig"
rsource "windows/Kconfig"
rsource "x11/Kconfig"

config LV_USE_NANOVG
	bool "NanoVG library"
	default n
	help
		Enable NanoVG (vector graphics library)

endmenu
```

## src/drivers/display/drm/Kconfig
```kconfig
config LV_USE_LINUX_DRM
	bool "Use Linux DRM device"
	default n
	help
		Driver for /dev/dri/card

if LV_USE_LINUX_DRM

config LV_LINUX_DRM_AUTO_BACKEND
	bool "Auto-select the DRM backend (legacy)"
	default y
	help
	  Legacy behavior, kept for backwards compatibility and slated for removal.
	  While set, the backend is inferred from LV_USE_OPENGLES (EGL when OpenGLES
	  is enabled).  Disable this and pick a backend explicitly via the Linux DRM
	  "Rendering backend" choice.

choice
	prompt "Rendering backend"
	default LV_LINUX_DRM_BACKEND_FBDEV
	depends on !LV_LINUX_DRM_AUTO_BACKEND
	help
	  Select how the Linux DRM driver presents rendered frames.

	config LV_LINUX_DRM_BACKEND_FBDEV
		bool "Dumb buffers (no GPU)"
		help
		  Software rendering into DRM/KMS dumb buffers.

	config LV_LINUX_DRM_BACKEND_GBM
		bool "GBM DMA buffers"
		select LV_USE_LINUX_DRM_GBM_BUFFERS
		help
		  Use MESA GBM for Linux DRM DMA buffers.

	config LV_LINUX_DRM_BACKEND_EGL
		bool "EGL (OpenGL ES, hardware-accelerated)"
		select LV_LINUX_DRM_USE_EGL
		select LV_USE_LINUX_DRM_GBM_BUFFERS
		select LV_USE_OPENGLES
		help
		  Hardware-accelerated rendering via OpenGL ES 2.0 and EGL.
		  Requires OpenGL ES 2.0 on the target hardware and linking with
		  -lEGL.  Compatible with LVGL 3D/glTF rendering.  Implies GBM buffers.
endchoice

config LV_LINUX_DRM_BACKEND
	int
	default 0 if LV_LINUX_DRM_BACKEND_FBDEV
	default 1 if LV_LINUX_DRM_BACKEND_GBM
	default 2 if LV_LINUX_DRM_BACKEND_EGL

config LV_LINUX_DRM_USE_EGL
	bool
	select LV_USE_EGL

config LV_USE_LINUX_DRM_GBM_BUFFERS
	bool

endif # LV_USE_LINUX_DRM
```

## src/libs/frogfs/Kconfig
```kconfig
menu "FrogFS"

choice
	prompt "Log level"
	default FROGFS_LOG_LEVEL_WARN
	help
		This option sets the log level for FrogFS.

config FROGFS_LOG_LEVEL_NONE
	bool "None"

config FROGFS_LOG_LEVEL_ERROR
	bool "Error"

config FROGFS_LOG_LEVEL_WARN
	bool "Warning"

config FROGFS_LOG_LEVEL_INFO
	bool "Info"

config FROGFS_LOG_LEVEL_DEBUG
	bool "Debug"

config FROGFS_LOG_LEVEL_VERBOSE
	bool "Verbose"

endchoice # "Log level"

config FROGFS_USE_MINIZ
	bool "Use miniz for gzip and zlib compression"
	default y if !IDF_TARGET_ESP8266
	help
		If enabled, this will enable support for decompressing files using
		miniz for gzip and zlib formats using the deflate algorithm.

config FROGFS_USE_ZLIB
	bool "Use zlib for gzip and zlib compression"
	default n
	help
		If enabled, this will enable support for decompressing files using
		zlib for gzip and zlib formats using the deflate algorithm.

		This requires zlib as a project dependency.

config FROGFS_USE_HEATSHRINK
	bool "Use heatshrink"
	default n
	help
		If enabled, this will enable support for decompressing files using
		the heatshrink algorithm.

config FROGFS_MAX_PARTITIONS
	int "Max partitions"
	default 1
	help
		This option specifies the number of partitions that can be mounted
		using VFS at the same time.

config FROGFS_VFS_SUPPORT_DIR
	bool "Compile in VFS directory functions"
	default y
	depends on VFS_SUPPORT_DIR
	help
		This option if enabled includes the following VFS functions:

		stat, opendir, readdir, telldir, seekdir, closedir, and access

endmenu
```

## src/widgets/calendar/Kconfig
```kconfig
config LV_USE_CALENDAR
	bool "Calendar"
	default y

if LV_USE_CALENDAR
config LV_CALENDAR_WEEK_STARTS_MONDAY
	bool "Calendar week starts monday"

menu "Days name configuration"
	depends on LV_USE_CALENDAR

config LV_MONDAY_STR
	string "Shortened string for Monday"
	default "Mo"
config LV_TUESDAY_STR
	string "Shortened string for Tuesday"
	default "Tu"
config LV_WEDNESDAY_STR
	string "Shortened string for Wednesday"
	default "We"
config LV_THURSDAY_STR
	string "Shortened string for Thursday"
	default "Th"
config LV_FRIDAY_STR
	string "Shortened string for Friday"
	default "Fr"
config LV_SATURDAY_STR
	string "Shortened string for Saturday"
	default "Sa"
config LV_SUNDAY_STR
	string "Shortened string for Sunday"
	default "Su"

endmenu

menu "Month names configuration"
	depends on LV_USE_CALENDAR
config LV_JANUARY_STR
	string "String for January"
	default "January"
config LV_FEBRUARY_STR
	string "String for February"
	default "February"
config LV_MARCH_STR
	string "String for March"
	default "March"
config LV_APRIL_STR
	string "String for April"
	default "April"
config LV_MAY_STR
	string "String for May"
	default "May"
config LV_JUNE_STR
	string "String for June"
	default "June"
config LV_JULY_STR
	string "String for July"
	default "July"
config LV_AUGUST_STR
	string "String for August"
	default "August"
config LV_SEPTEMBER_STR
	string "String for September"
	default "September"
config LV_OCTOBER_STR
	string "String for October"
	default "October"
config LV_NOVEMBER_STR
	string "String for November"
	default "November"
config LV_DECEMBER_STR
	string "String for December"
	default "December"
endmenu

config LV_USE_CALENDAR_HEADER_ARROW
	bool "Use calendar header arrow"
	default y

config LV_USE_CALENDAR_HEADER_DROPDOWN
	bool "Use calendar header dropdown"
	default y

config LV_USE_CALENDAR_CHINESE
	bool "Use chinese calendar"
	default n

endif #LV_USE_CALENDAR
	
```

## zephyr/Kconfig.graphical
```kconfig
# Copyright (c) 2018-2019 Jan Van Winkel <jan.van_winkel@dxplore.eu>
# Copyright (c) 2020 Teslabs Engineering S.L.
# SPDX-License-Identifier: Apache-2.0

menu "Graphical settings"

DT_CHOSEN_ZEPHYR_DISPLAY := zephyr,display
DT_CZD_PATH:= $(dt_chosen_path,$(DT_CHOSEN_ZEPHYR_DISPLAY))
DT_CZD_HOR_RES_MAX := $(dt_node_int_prop_int,$(DT_CZD_PATH),width)
DT_CZD_VER_RES_MAX := $(dt_node_int_prop_int,$(DT_CZD_PATH),height)

config LV_Z_HOR_RES_MAX
	int "Horizontal Screen Resolution"
	default "$(DT_CZD_HOR_RES_MAX)" if HAS_DTS
	default 480
	help
	  Horizontal screen resolution in pixels

config LV_Z_VER_RES_MAX
	int "Vertical Screen Resolution"
	default "$(DT_CZD_VER_RES_MAX)" if HAS_DTS
	default 320
	help
	  Vertical screen resolution in pixels

endmenu
```

## zephyr/Kconfig.input
```kconfig
# Copyright (c) 2018-2019 Jan Van Winkel <jan.van_winkel@dxplore.eu>
# Copyright (c) 2020 Teslabs Engineering S.L.
# SPDX-License-Identifier: Apache-2.0

menu "Input device settings"

config LV_Z_POINTER_KSCAN
	bool "Keyboard scan pointer input"
	depends on KSCAN
	help
	  Enable keyboard scan pointer input

if LV_Z_POINTER_KSCAN

config LV_Z_POINTER_KSCAN_MSGQ_COUNT
	int "Keyboard scan message queue count maximum"
	default 10
	help
	  Maximum number of items in the keyboard scan message queue.

config LV_Z_POINTER_KSCAN_SWAP_XY
	bool "Swap keyboard scan X,Y axes"
	help
	  Swap keyboard scan X,Y axes. This option can be used to align keyboard
	  scan coordinates with the display.

config LV_Z_POINTER_KSCAN_INVERT_X
	bool "Invert keyboard scan X axis"
	help
	  Invert keyboard scan X axis. This option can be used to align keyboard
	  scan coordinates with the display.

config LV_Z_POINTER_KSCAN_INVERT_Y
	bool "Invert keyboard scan Y axis"
	help
	  Invert keyboard scan Y axis. This option can be used to align keyboard
	  scan coordinates with the display.

endif # LV_Z_POINTER_KSCAN

endmenu
```
