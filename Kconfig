## demos/benchmark/Kconfig
```kconfig
config LV_USE_DEMO_BENCHMARK
	bool "Benchmark demo"
	default n
	select LV_FONT_MONTSERRAT_14
	select LV_FONT_MONTSERRAT_20
	select LV_FONT_MONTSERRAT_24
	select LV_FONT_MONTSERRAT_26
	select LV_USE_DEMO_WIDGETS

config LV_DEMO_BENCHMARK_ALIGNED_FONTS
	depends on LV_USE_DEMO_BENCHMARK
	bool "Aligned fonts"
	default n
	help
		Use the demo's own Montserrat fonts with aligned glyph bitmaps instead
		of the LV_FONT_MONTSERRAT_* fonts.
```

## demos/keypad_encoder/Kconfig
```kconfig
config LV_USE_DEMO_KEYPAD_AND_ENCODER
	bool "Keypad and encoder demo"
	default n
```

## demos/music/Kconfig
```kconfig
config LV_USE_DEMO_MUSIC
	bool "Music player demo"
	default n
if LV_USE_DEMO_MUSIC

config LV_DEMO_MUSIC_SQUARE
	bool "Square layout"
	default n

config LV_DEMO_MUSIC_LANDSCAPE
	bool "Landscape layout"
	default n

config LV_DEMO_MUSIC_ROUND
	bool "Round layout"
	default n

config LV_DEMO_MUSIC_LARGE
	bool "Large layout"
	default n

config LV_DEMO_MUSIC_AUTO_PLAY
	bool "Auto play"
	default n

endif #LV_USE_DEMO_MUSIC
```

## demos/render/Kconfig
```kconfig
config LV_USE_DEMO_RENDER
	bool "Render demo"
	select LV_USE_GRID
	default n
	help
		Renders each drawing primitive for visual comparison.
		Requires a display of at least 480x272.
```

## demos/vector_graphic/Kconfig
```kconfig
config LV_USE_DEMO_VECTOR_GRAPHIC
	bool "Vector graphic demo"
	default n
	depends on LV_DRAW_HAS_VECTOR_SUPPORT
	select LV_USE_VECTOR_GRAPHIC
```

## env_support/irq_providers/cmsis/Kconfig
```kconfig
# CMSIS IRQ provider: defines the named NVIC vectors on Cortex-M.

config LV_IRQ_PROVIDER_CMSIS
	int
	default 1

choice LV_IRQ_DEFAULT_PROVIDER
	config LV_IRQ_DEFAULT_PROVIDER_CMSIS
		bool "CMSIS (NVIC)"
endchoice

choice LV_IRQ_DMA2D_PROVIDER_CHOICE
	config LV_IRQ_DMA2D_PROVIDER_CMSIS
		bool "CMSIS (NVIC)"
		help
			Defines DMA2D_IRQHandler, so the application must not define it too.
endchoice

config LV_IRQ_DMA2D_PROVIDER
	int
	default LV_IRQ_PROVIDER_CMSIS if LV_IRQ_DMA2D_PROVIDER_CMSIS || (LV_IRQ_DMA2D_PROVIDER_DEFAULT && LV_IRQ_DEFAULT_PROVIDER_CMSIS)

choice LV_IRQ_PXP_PROVIDER_CHOICE
	config LV_IRQ_PXP_PROVIDER_CMSIS
		bool "CMSIS (NVIC)"
		help
			Defines PXP_IRQHandler, so the application must not define it too.
endchoice

config LV_IRQ_PXP_PROVIDER
	int
	default LV_IRQ_PROVIDER_CMSIS if LV_IRQ_PXP_PROVIDER_CMSIS || (LV_IRQ_PXP_PROVIDER_DEFAULT && LV_IRQ_DEFAULT_PROVIDER_CMSIS)
if LV_IRQ_DMA2D_PROVIDER = LV_IRQ_PROVIDER_CMSIS || LV_IRQ_PXP_PROVIDER = LV_IRQ_PROVIDER_CMSIS

config LV_IRQ_CMSIS_USE_INCLUDE
	bool "CMSIS provider: include a device header"
	help
		Include the device header that declares the IRQn_Type values
		(DMA2D_IRQn, PXP_IRQn, ...) and the NVIC_* functions. Leave disabled if
		the build already makes them visible.

config LV_IRQ_CMSIS_INCLUDE
	string "CMSIS provider: device header"
	default ""
	depends on LV_IRQ_CMSIS_USE_INCLUDE
	help
		For example "stm32h7xx.h".

config LV_IRQ_CMSIS_SET_PRIORITY
	bool "CMSIS provider: set the NVIC priority"
	help
		Enable on RTOS builds where the interrupt priority must sit at or below
		the kernel's syscall interrupt priority ceiling, so the ISR may call the
		kernel's ...FromISR APIs (lv_thread_sync_signal_isr uses one). Leave
		disabled on bare metal, where the reset-default priority is fine.

config LV_IRQ_CMSIS_PRIORITY
	int "CMSIS provider: NVIC priority value"
	default 255
	depends on LV_IRQ_CMSIS_SET_PRIORITY
	help
		The value passed to NVIC_SetPriority. 255 maps to the lowest preemption
		priority whatever __NVIC_PRIO_BITS is: always safe for ...FromISR calls,
		at the cost of latency. Under FreeRTOS the best latency is
		configLIBRARY_MAX_SYSCALL_INTERRUPT_PRIORITY + 1 (a hand-written lv_conf.h
		may write it symbolically; Kconfig takes a literal number).

endif
```

## env_support/irq_providers/nema_stm32/Kconfig
```kconfig
# NemaGFX STM32 HAL IRQ provider: the GPU2D command-list completion delivered
# by the STM32 HAL.

config LV_IRQ_PROVIDER_NEMA_STM32
	int
	default 3

choice LV_IRQ_DEFAULT_PROVIDER
	config LV_IRQ_DEFAULT_PROVIDER_NEMA_STM32
		bool "NemaGFX STM32 HAL"
		depends on LV_USE_NEMA_GFX && LV_NEMA_HAL_STM32
endchoice

choice LV_IRQ_NEMA_GPU2D_PROVIDER_CHOICE
	config LV_IRQ_NEMA_GPU2D_PROVIDER_NEMA_STM32
		bool "NemaGFX STM32 HAL"
		depends on LV_USE_NEMA_GFX && LV_NEMA_HAL_STM32
endchoice

config LV_IRQ_NEMA_GPU2D_PROVIDER
	int
	default LV_IRQ_PROVIDER_NEMA_STM32 if LV_IRQ_NEMA_GPU2D_PROVIDER_NEMA_STM32 || (LV_IRQ_NEMA_GPU2D_PROVIDER_DEFAULT && LV_IRQ_DEFAULT_PROVIDER_NEMA_STM32)
```

## env_support/irq_providers/zephyr/Kconfig
```kconfig
# Zephyr IRQ provider: IRQ_CONNECT with the number and priority from the
# device tree.

config LV_IRQ_PROVIDER_ZEPHYR
	int
	default 2

choice LV_IRQ_DEFAULT_PROVIDER
	config LV_IRQ_DEFAULT_PROVIDER_ZEPHYR
		bool "Zephyr (device tree)"
endchoice

choice LV_IRQ_DMA2D_PROVIDER_CHOICE
	config LV_IRQ_DMA2D_PROVIDER_ZEPHYR
		bool "Zephyr (device tree)"
		help
			Needs a dma2d node in the device tree.
endchoice

config LV_IRQ_DMA2D_PROVIDER
	int
	default LV_IRQ_PROVIDER_ZEPHYR if LV_IRQ_DMA2D_PROVIDER_ZEPHYR || (LV_IRQ_DMA2D_PROVIDER_DEFAULT && LV_IRQ_DEFAULT_PROVIDER_ZEPHYR)

choice LV_IRQ_PXP_PROVIDER_CHOICE
	config LV_IRQ_PXP_PROVIDER_ZEPHYR
		bool "Zephyr (device tree)"
		help
			Needs a pxp node in the device tree.
endchoice

config LV_IRQ_PXP_PROVIDER
	int
	default LV_IRQ_PROVIDER_ZEPHYR if LV_IRQ_PXP_PROVIDER_ZEPHYR || (LV_IRQ_PXP_PROVIDER_DEFAULT && LV_IRQ_DEFAULT_PROVIDER_ZEPHYR)
```

## env_support/kconfig/Kconfig.build
```kconfig
menu "Build"

config LVGL_VERSION_MAJOR
	int
	default 9
config LVGL_VERSION_MINOR
	int
	default 6
config LVGL_VERSION_PATCH
	int
	default 0

config LV_CONF_SKIP
	bool "Skip lv_conf.h"
	default y
	help
	  Do not include lv_conf.h; take the configuration from this Kconfig
	  tree and the built-in defaults instead.

config LV_CONF_MINIMAL
	bool "Minimal configuration [DEPRECATED: use the minimal defconfig]"
	default n
	help
	  Deprecated and no longer functional. The minimal preset is now a
	  defconfig: configs/defconfigs/minimal.defconfig. Setting this has no
	  effect on the generated configuration and triggers a build warning.

config LV_USE_PRIVATE_API
	bool "Private API (lvgl_private.h)"
	default n
	help
	  Include `lvgl_private.h` from `lvgl.h` so that LVGL internal data
	  structures and functions are accessible by default.

config LV_ENABLE_GLOBAL_CUSTOM
	bool "'lv_global' customization"
	default n
	help
	  By default, LVGL stores all runtime state in a single static
	  'lv_global_t' variable, sufficient for most single-display
	  single-threaded applications.

	  Enable this if you need multiple independent LVGL instances in
	  the same process, for example:
	    - Multiple physical displays with separate render loops
	    - Per-thread LVGL contexts on an RTOS (FreeRTOS, Zephyr, etc.)
	    - Hot-swappable or sandboxed UI instances

	  When enabled, every LVGL internal access to global state goes
	  through LV_GLOBAL_CUSTOM() instead of a static variable. You
	  must implement 'lv_global_t *lv_global_default(void)' to return
	  the correct instance for the current context (e.g. by thread-local
	  storage or a guarded pointer switch).

	  Returning NULL from that function is safe; LVGL will treat the
	  library as uninitialized for that context.

if LV_ENABLE_GLOBAL_CUSTOM

config LV_GLOBAL_USE_CUSTOM_INCLUDE
	bool "Custom 'lv_global_default()' header"
	help
	  Use a custom header for the declaration of:
	  	lv_global_t *lv_global_default(void);

config LV_GLOBAL_CUSTOM_INCLUDE
	string "Path to custom 'lv_global' header"
	depends on LV_GLOBAL_USE_CUSTOM_INCLUDE
	default "lv_global.h"
	help
	  Path to the header that declares:
	    lv_global_t *lv_global_default(void);

	  This header is included wherever LVGL needs to resolve the
	  LV_GLOBAL_DEFAULT() macro. Keep it lightweight, it is included
	  in performance-critical paths.

endif #LV_ENABLE_GLOBAL_CUSTOM

menu "Asserts"
	config LV_USE_ASSERT_NULL
		bool "NULL checks (very fast, recommended)"
		default y

	config LV_USE_ASSERT_MALLOC
		bool "Allocation success checks (very fast, recommended)"
		default y

	config LV_USE_ASSERT_STYLE
		bool "Style init checks (very fast, recommended)"

	config LV_USE_ASSERT_MEM_INTEGRITY
		bool "lv_mem integrity checks (slow)"

	config LV_USE_ASSERT_OBJ
		bool "Widget validity checks (slow)"

	config LV_ASSERT_HANDLER_INCLUDE
		string "Assert handler header [DEPRECATED: use LV_ASSERT_CUSTOM_INCLUDE]"
		default ""
		help
		  [DEPRECATED: use LV_ASSERT_CUSTOM_INCLUDE]
		  Add a custom handler when assert happens e.g. to restart the MCU
		  Optional header to override assert-related macros.

	config LV_WARN_ABOUT_ASSERT_HANDLER_INCLUDE
		bool
		default y if LV_ASSERT_HANDLER_INCLUDE != ""

	config LV_DISABLE_ASSERT_HANDLER_INCLUDE_WARNING
		bool "Disable LV_ASSERT_HANDLER_INCLUDE deprecated warning"
		default n
		help
		  Disable warning saying `LV_ASSERT_HANDLER_INCLUDE` is deprecated.
		  This setting allows you to keep using old LVGL versions which rely on
		  LV_ASSERT_HANDLER_INCLUDE without triggering a compiler warning.

		  LV_ASSERT_HANDLER_INCLUDE has been deprecated in favor of the new approach:
		  define LV_ASSERT_CUSTOM_INCLUDE with the header path, and place the
		  LV_ASSERT_HANDLER macro definition inside that header instead.

		  Only enable this if you are maintaining compatibility with existing code
		  that uses LV_ASSERT_HANDLER_INCLUDE and cannot migrate immediately.
		  New projects should use LV_ASSERT_CUSTOM_INCLUDE and LV_ASSERT_HANDLER
		  directly.

	config LV_ASSERT_USE_CUSTOM_INCLUDE
		bool "Custom assert handler header"
		default n
		help
		  Include the header given by LV_ASSERT_CUSTOM_INCLUDE, which must define
		  a custom LV_ASSERT_HANDLER.

	config LV_ASSERT_CUSTOM_INCLUDE
		string "Path to custom assert handler header"
		default ""
		depends on LV_ASSERT_USE_CUSTOM_INCLUDE
		help
		  Optional header to override assert-related macros.

		  LV_ASSERT_HANDLER
		    Statement to execute when an assertion fails.
		    e.g. #define LV_ASSERT_HANDLER my_assert_failed(__FILE__, __LINE__);

endmenu

menu "Argument Checks"
	config LV_USE_CHECK_ARG
		bool "Runtime argument validation"
		default y
		help
			LV_CHECK_ARG validates function arguments at runtime: a failed check
			logs a warning and executes the specified action. When disabled all
			these checks compile to nothing, which is only safe in very resource
			constrained environments where invariants are guaranteed to hold.

	if LV_USE_CHECK_ARG

	config LV_CHECK_ARG_ASSERT_ON_FAIL
		bool "Assert on failure"
		default n
		help
			Also invoke LV_ASSERT_HANDLER when an LV_CHECK_ARG check fails,
			before the action is executed.

	choice
		prompt "Log behavior on LV_CHECK_ARG failure"
		default LV_CHECK_ARG_LOG_MODE_VERBOSE if LV_USE_LOG
		default LV_CHECK_ARG_LOG_MODE_NONE if !LV_USE_LOG
		help
			Controls what is logged when an LV_CHECK_ARG check fails.
			Minimal and Verbose require LV_USE_LOG; selecting either without it
			causes a compile-time error.

		config LV_CHECK_ARG_LOG_MODE_NONE
			bool "None: no log output on failure"

		config LV_CHECK_ARG_LOG_MODE_MINIMAL
			bool "Minimal: log 'Check failed' only (file/line from LV_LOG_WARN)"
			depends on LV_USE_LOG

		config LV_CHECK_ARG_LOG_MODE_VERBOSE
			bool "Verbose: log 'Check failed: <cond>' plus caller-supplied message"
			depends on LV_USE_LOG

	endchoice

	config LV_CHECK_ARG_LOG_MODE
		int
		default 0 if LV_CHECK_ARG_LOG_MODE_NONE
		default 1 if LV_CHECK_ARG_LOG_MODE_MINIMAL
		default 2 if LV_CHECK_ARG_LOG_MODE_VERBOSE

	config LV_USE_CHECK_OBJ_CLASSTYPE
		bool "Class check in LV_CHECK_OBJ"
		default y
		help
			LV_CHECK_OBJ verifies with lv_obj_has_class() that the object has the
			expected class. When disabled the check is skipped even if a class
			argument is supplied.

	config LV_USE_CHECK_OBJ_VALIDITY
		bool "Widget-tree validity check in LV_CHECK_OBJ"
		default n
		help
			LV_CHECK_OBJ verifies with lv_obj_is_valid() that the object is still
			part of the widget tree. When disabled the check is skipped even if the
			associated argument is supplied.
	endif
endmenu
endmenu #"Build"
```

## examples/Kconfig
```kconfig
menu "Examples"
config LV_BUILD_EXAMPLES
	bool "Build examples"
	default y

endmenu #"Examples"
```

## src/core/Kconfig
```kconfig
menu "Core"

config LV_OBJ_STYLE_CACHE
	bool "Style cache"
	default n
	help
		Speed up style property lookups by adding 2 x 32 bit variables to each lv_obj_t.

config LV_USE_OBJ_NAME
	bool "Widget names (lv_obj_set_name)"
	default n

config LV_USE_OBJ_ID
	bool "Widget id (lv_obj_set_id)"
	default n

if LV_USE_OBJ_ID

config LV_OBJ_ID_AUTO_ASSIGN
	bool "Automatic ID assignment on widget creation"
	default y

config LV_USE_OBJ_ID_BUILTIN
	bool "Built-in ID handler"
	default y
	help
		Use builtin obj ID handler functions:
		- lv_obj_assign_id:       Called when a widget is created. Use a separate counter for each widget class as an ID.
		- lv_obj_id_compare:      Compare the ID to decide if it matches with a requested value.
		- lv_obj_stringify_id:    Return string-ified identifier, e.g. "button3".
		- lv_obj_free_id:         Does nothing, as there is no memory allocation for the ID.
		When disabled these functions needs to be implemented by the user.

endif #LV_USE_OBJ_ID

config LV_USE_OBJ_PROPERTY
	bool "Generic widget property set/get API"
	default n
	help
		Get and set any widget style or attribute through a single generic property ID based API.

if LV_USE_OBJ_PROPERTY

config LV_USE_OBJ_PROPERTY_NAME
	bool "Access properties by name"
	default y
	help
		Add a name table to every widget class, so the property can be accessed by name.
		Note, the const table will increase flash usage.

endif #LV_USE_OBJ_PROPERTY

config LV_USE_EXT_DATA
	bool "External data and destructor"
	default n
	help
		Attach your own data plus a destructor callback to events, widgets, observers,
		animations, timers, groups, displays, input devices and themes, so your resources
		are cleaned up when LVGL frees them.

config LV_USE_FLOAT
	bool "Float as lv_value_precise_t"
	default n
	help
		Use `float` instead of `int32_t` for coordinates and values that need sub-pixel precision.

config LV_USE_OBSERVER
	bool "Observer"
	default y
	help
		Bind widgets to subject variables so they update automatically when the value changes.

config LV_USE_TRANSLATION
	bool "Text translation"
	help
		Look up strings by ID for the selected language with lv_translation_get().

config LV_USE_COLOR_FILTER
	bool "Color filter style"
	default n

endmenu #"Core"
```

## src/debugging/Kconfig
```kconfig
menu "Debugging"
menu "System Monitoring"
	rsource "sysmon/Kconfig"
endmenu

menu "Profiler"
	rsource "profiler/Kconfig"
endmenu

menu "Test Utilities"
	rsource "test/Kconfig"

	config LV_USE_MONKEY
		bool "Monkey test"
		default n
		help
			Feed random input events to the UI for stress testing.
endmenu

menu "Debug Rendering"

config LV_USE_REFR_DEBUG
	bool "Redraw area overlay"
	help
		Draw random colored rectangles over the redrawn areas.

config LV_USE_LAYER_DEBUG
	bool "Layer type overlay"
	help
		Draw a red overlay over ARGB layers and a green overlay over RGB layers.

config LV_USE_PARALLEL_DRAW_DEBUG
	bool "Draw unit overlay"
	help
		Draw an overlay in a different color for each draw unit's tasks, with the
		draw unit's index number on a white background (black for layers).
endmenu
endmenu
```
