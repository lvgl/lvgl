## src/debugging/profiler/Kconfig
```kconfig
config LV_USE_PROFILER
	bool "Profiler"
	default n
	help
		Instrument LVGL internals with trace hooks to measure runtime performance.

config LV_USE_PROFILER_BUILTIN
	bool "Built-in profiler"
	default n
	select LV_USE_PROFILER

if LV_USE_PROFILER_BUILTIN

config LV_PROFILER_BUILTIN_BUF_SIZE
	int "Trace buffer size (bytes)"
	default 16384

config LV_PROFILER_BUILTIN_DEFAULT_ENABLE
	bool "Start profiling at init"
	default y

config LV_USE_PROFILER_BUILTIN_POSIX
	bool "POSIX port"
	default n


endif #LV_USE_PROFILER_BUILTIN

if LV_USE_PROFILER

config LV_PROFILER_INCLUDE
	string "Profiler header"
	default "lvgl/debugging/profiler/lv_profiler_builtin.h"
	help
	  Path to a header that defines the following profiler hook macros:

	  LV_PROFILER_BEGIN
	    Called at the start of a profiled scope.
	    e.g. #define LV_PROFILER_BEGIN  my_profiler_begin()

	  LV_PROFILER_END
	    Called at the end of a profiled scope.
	    e.g. #define LV_PROFILER_END    my_profiler_end()

	  LV_PROFILER_BEGIN_TAG(tag)
	    Called at the start of a profiled scope with a string tag.
	    e.g. #define LV_PROFILER_BEGIN_TAG(tag)  my_profiler_begin_tag(tag)

	  LV_PROFILER_END_TAG(tag)
	    Called at the end of a profiled scope with a string tag.
	    e.g. #define LV_PROFILER_END_TAG(tag)    my_profiler_end_tag(tag)

	  The default header provides these via the built-in profiler.
	  Set this to your own header to use a custom profiler backend.

menu "Profiled modules"

config LV_PROFILER_LAYOUT
	bool "Layout"
	default y

config LV_PROFILER_REFR
	bool "Display refresh"
	default y

config LV_PROFILER_DRAW
	bool "Draw"
	default y

config LV_PROFILER_INDEV
	bool "Input devices"
	default y

config LV_PROFILER_DECODER
	bool "Image decoder"
	default y

config LV_PROFILER_FONT
	bool "Font"
	default y

config LV_PROFILER_FS
	bool "File system"
	default y

config LV_PROFILER_STYLE
	bool "Style"
	default n

config LV_PROFILER_TIMER
	bool "Timer"
	default y

config LV_PROFILER_CACHE
	bool "Cache"
	default y

config LV_PROFILER_EVENT
	bool "Events"
	default y

endmenu

endif # LV_USE_PROFILER
```

## src/debugging/sysmon/Kconfig
```kconfig
config LV_USE_SYSMON
	bool "System monitor"
	default n
	help
		Periodically collect CPU, FPS and memory statistics and optionally show them in an
		on-screen overlay.

if LV_USE_SYSMON

config LV_SYSMON_PROC_IDLE_AVAILABLE
	bool "Per-process idle measurement"
	default n
	help
		The port provides `lv_os_get_proc_idle_percent` a per-process idle percentage
		in addition to the system-wide one. LVGL provides a default one for linux systems.

config LV_USE_PERF_MONITOR
	bool "Performance monitor"
	default n
	help
		Show the CPU usage and FPS count in a label on the screen.

choice
	prompt "Performance monitor position"
	depends on LV_USE_PERF_MONITOR
	default LV_PERF_MONITOR_ALIGN_BOTTOM_RIGHT

	config LV_PERF_MONITOR_ALIGN_TOP_LEFT
		bool "Top left"
	config LV_PERF_MONITOR_ALIGN_TOP_MID
		bool "Top middle"
	config LV_PERF_MONITOR_ALIGN_TOP_RIGHT
		bool "Top right"
	config LV_PERF_MONITOR_ALIGN_BOTTOM_LEFT
		bool "Bottom left"
	config LV_PERF_MONITOR_ALIGN_BOTTOM_MID
		bool "Bottom middle"
	config LV_PERF_MONITOR_ALIGN_BOTTOM_RIGHT
		bool "Bottom right"
	config LV_PERF_MONITOR_ALIGN_LEFT_MID
		bool "Left middle"
	config LV_PERF_MONITOR_ALIGN_RIGHT_MID
		bool "Right middle"
	config LV_PERF_MONITOR_ALIGN_CENTER
		bool "Center"
endchoice

config LV_USE_PERF_MONITOR_LOG_MODE
	bool "Log performance data"
	depends on LV_USE_PERF_MONITOR
	default n
	help
		Print the performance data to the log instead of showing the on-screen label.

config LV_USE_MEM_MONITOR
	bool "Memory monitor"
	default n
	depends on LV_USE_BUILTIN_MALLOC
	help
		Show the used memory and the memory fragmentation in a label on the screen.

choice
	prompt "Memory monitor position"
	depends on LV_USE_MEM_MONITOR
	default LV_MEM_MONITOR_ALIGN_BOTTOM_LEFT

	config LV_MEM_MONITOR_ALIGN_TOP_LEFT
		bool "Top left"
	config LV_MEM_MONITOR_ALIGN_TOP_MID
		bool "Top middle"
	config LV_MEM_MONITOR_ALIGN_TOP_RIGHT
		bool "Top right"
	config LV_MEM_MONITOR_ALIGN_BOTTOM_LEFT
		bool "Bottom left"
	config LV_MEM_MONITOR_ALIGN_BOTTOM_MID
		bool "Bottom middle"
	config LV_MEM_MONITOR_ALIGN_BOTTOM_RIGHT
		bool "Bottom right"
	config LV_MEM_MONITOR_ALIGN_LEFT_MID
		bool "Left middle"
	config LV_MEM_MONITOR_ALIGN_RIGHT_MID
		bool "Right middle"
	config LV_MEM_MONITOR_ALIGN_CENTER
		bool "Center"
endchoice

config LV_SYSMON_USE_CUSTOM_INCLUDE
	bool "Custom sysmon header"
	default n
	help
	  Include the header given by LV_SYSMON_CUSTOM_INCLUDE to override system
	  monitor macros such as LV_SYSMON_GET_IDLE.

config LV_SYSMON_CUSTOM_INCLUDE
	string "Path to custom sysmon header"
	default ""
	depends on LV_SYSMON_USE_CUSTOM_INCLUDE
	help
	  Optional header to override system monitor idle measurement macros.

	  LV_SYSMON_GET_IDLE
	    Expression returning the CPU idle percentage (0-100) since last call.
	    e.g. my_rtos_get_idle_percent()

	  LV_SYSMON_GET_PROC_IDLE
	    Expression returning per-process idle percentage, if supported by
	    the RTOS. Requires LV_SYSMON_PROC_IDLE_AVAILABLE to be enabled
	    e.g. my_rtos_get_proc_idle_percent()

endif #LV_USE_SYSMON
```

## src/debugging/test/Kconfig
```kconfig
config LV_USE_TEST
	bool "Test utilities"
	help
		Emulated input devices, time emulation, and screenshot compares.

if LV_USE_TEST

config LV_USE_TEST_SCREENSHOT_COMPARE
	bool "Screenshot compare"
	select LV_USE_LODEPNG
	help
		Enable `lv_test_screenshot_compare()`. Requires a few MB of extra RAM.

config LV_TEST_SCREENSHOT_CREATE_REFERENCE_IMAGE
	bool "Create missing reference images"
	default y
	depends on LV_USE_TEST_SCREENSHOT_COMPARE
	help
		When a reference image does not exist yet, create it from the rendered
		screen instead of failing the compare.

config LV_USE_NANOVG_TEST_HEADLESS
	bool "Headless EGL display for NanoVG"
	depends on LV_USE_DRAW_NANOVG
	help
		Render into an off-screen EGL pbuffer instead of a window and read the
		pixels back into the LVGL draw buffer, so screenshot compares work the
		same way as with the software renderer. Requires EGL and GLESv2.

endif #LV_USE_TEST
```

## src/draw/Kconfig
```kconfig
menu "Rendering Configuration"

menu "Color Settings"

	choice LV_COLOR_FORMAT_DEFAULT
		prompt "Default color format"
		default LV_COLOR_FORMAT_I1       if LV_COLOR_DEPTH_1
		default LV_COLOR_FORMAT_L8       if LV_COLOR_DEPTH_8
		default LV_COLOR_FORMAT_RGB888   if LV_COLOR_DEPTH_24
		default LV_COLOR_FORMAT_XRGB8888 if LV_COLOR_DEPTH_32
		default LV_COLOR_FORMAT_RGB565

		config LV_COLOR_FORMAT_I1
			bool "I1"
			imply LV_FONT_UNSCII_8
		config LV_COLOR_FORMAT_L8
			bool "L8"
			imply LV_FONT_UNSCII_8
		config LV_COLOR_FORMAT_RGB565
			bool "RGB565"
			imply LV_FONT_MONTSERRAT_14
		config LV_COLOR_FORMAT_RGB565_SWAPPED
			bool "RGB565 (Big-endian)"
			imply LV_FONT_MONTSERRAT_14
		config LV_COLOR_FORMAT_RGB888
			bool "RGB888"
			imply LV_FONT_MONTSERRAT_14
		config LV_COLOR_FORMAT_XRGB8888
			bool "XRGB8888"
			imply LV_FONT_MONTSERRAT_14
		config LV_COLOR_FORMAT_ARGB8888
			bool "ARGB8888"
			imply LV_FONT_MONTSERRAT_14
		config LV_COLOR_FORMAT_ARGB8888_PREMULTIPLIED
			bool "ARGB8888 (premultiplied)"
			imply LV_FONT_MONTSERRAT_14
	endchoice

	choice LV_COLOR_DEPTH_CHOICE
		prompt "Color depth [DEPRECATED: Use LV_COLOR_FORMAT_DEFAULT]"
		default LV_COLOR_DEPTH_UNSET
		config LV_COLOR_DEPTH_UNSET
			bool "Use LV_COLOR_FORMAT_DEFAULT"
		config LV_COLOR_DEPTH_32
			bool "32: XRGB8888"
			imply LV_FONT_MONTSERRAT_14
		config LV_COLOR_DEPTH_24
			bool "24: RGB888"
			imply LV_FONT_MONTSERRAT_14
		config LV_COLOR_DEPTH_16
			bool "16: RGB565"
			imply LV_FONT_MONTSERRAT_14
		config LV_COLOR_DEPTH_8
			bool "8: L8 (grayscale)"
			imply LV_FONT_UNSCII_8
		config LV_COLOR_DEPTH_1
			bool "1: I1 (1 bit per pixel)"
			imply LV_FONT_MONTSERRAT_14
	endchoice

	config LV_COLOR_DEPTH
		int
		default 1 if LV_COLOR_FORMAT_I1
		default 8 if LV_COLOR_FORMAT_L8
		default 16 if LV_COLOR_FORMAT_RGB565 || LV_COLOR_FORMAT_RGB565_SWAPPED
		default 24 if LV_COLOR_FORMAT_RGB888
		default 32

	config LV_COLOR_MIX_ROUND_OFS
		int "Color mix rounding offset"
		default 0
		range 0 254
		help
			0: no adjustment, get the integer part of the result (round down)
			64: round up from x.75
			128: round up from half
			192: round up from x.25
			254: round up
endmenu

config LV_DRAW_HAS_VECTOR_SUPPORT
	bool
	default n

config LV_DRAW_HAS_3D_SUPPORT
	bool
	default n

config LV_DEF_REFR_PERIOD
	int "Default refresh period (ms)"
	default 33
	help
		Default display refresh, input device read and animation step period.

config LV_DPI_DEF
	int "Default DPI (px/inch)"
	default 130
	help
		Used to initialize default sizes such as widget sizes and style paddings.

config LV_DRAW_BUF_STRIDE_ALIGN
	int "Draw buffer stride alignment (bytes)"
	default 1
	help
		Align the stride of all layers and images to this many bytes.

config LV_DRAW_BUF_ALIGN
	int "Draw buffer address alignment (bytes)"
	default 4
	help
		Align the start address of draw_buf addresses to this many bytes.

config LV_USE_MATRIX
	bool "Matrix"
	default n
	select LV_USE_FLOAT
	help
		3x3 matrix API (lv_matrix_t) for transformations. Requires floating point support.

config LV_DRAW_TRANSFORM_USE_MATRIX
	bool "Matrix based transformations"
	default n
	depends on LV_USE_MATRIX
	help
		The rendering engine must support 3x3 matrix transformations.

config LV_DRAW_LAYER_SIMPLE_BUF_SIZE
	int "Simple layer buffer size (bytes)"
	default 24576
	help
		Widgets with `style_opa < 255` (not `bg_opa`, `text_opa` etc) or a non-NORMAL blend mode are
		buffered into a "simple" layer in chunks of this size.
		"Transformed layers" (if `transform_angle/zoom` are set) use larger buffers and can't be chunked.

config LV_DRAW_LAYER_MAX_MEMORY
	int "Maximum layer memory (bytes)"
	default 0
	help
		Limit for simple and transformed layers together; 0 means no limit.
		Must be at least `LV_DRAW_LAYER_SIMPLE_BUF_SIZE`, and with transformed layers large enough
		for the largest widget too (width x height x 4).

config LV_DRAW_THREAD_STACK_SIZE
	int "Draw thread stack size (bytes)"
	default 8192
	depends on !LV_OS_NONE
	help
		If FreeType or ThorVG is enabled, it is recommended to set it to 32KB or more.

config LV_DRAW_THREAD_PRIO
	int "Draw thread priority"
	range 0 4
	default 3
	depends on !LV_OS_NONE
	help
		Thread priority controls the relative importance of the drawing threads.
		Values correspond to lv_thread_prio_t enum in lv_os.h:
		0: LV_THREAD_PRIO_LOWEST
		1: LV_THREAD_PRIO_LOW
		2: LV_THREAD_PRIO_MID (default)
		3: LV_THREAD_PRIO_HIGH
		4: LV_THREAD_PRIO_HIGHEST

		Higher priority can improve rendering performance but might cause
		starvation of lower priority tasks.

config LV_USE_VECTOR_GRAPHIC
	bool "Vector graphics"
	default n
	select LV_USE_MATRIX
	help
		Vector drawing API (lv_vector_dsc_*) for paths, strokes and fills.
		Needs a renderer with vector support, e.g. the SW renderer with ThorVG, or VG-Lite.


rsource "snapshot/Kconfig"

config LV_USE_THORVG
	bool "Vector graphics engine (ThorVG)"
	default n
	select LV_DRAW_HAS_VECTOR_SUPPORT if LV_USE_DRAW_SW
	help
		Backend that gives the SW renderer vector graphics support.

config LV_USE_THORVG_INTERNAL
	bool "Bundled ThorVG"
	default y
	depends on LV_USE_THORVG
	help
		Build the ThorVG copy shipped with LVGL instead of linking an external one.


menu "SW"
rsource "sw/Kconfig"
endmenu

menu "VG-Lite"
rsource "vg_lite/Kconfig"
endmenu

menu "Dave2D"
rsource "renesas/dave2d/Kconfig"
endmenu

menu "NemaGFX"
rsource "nema_gfx/Kconfig"
endmenu

menu "PXP"
rsource "nxp/pxp/Kconfig"
endmenu

menu "PPA"
rsource "espressif/ppa/Kconfig"
endmenu

menu "DMA2D"
rsource "dma2d/Kconfig"
endmenu

menu "EVE"
rsource "eve/Kconfig"
endmenu

menu "G2D"
rsource "nxp/g2d/Kconfig"
endmenu

menu "NanoVG"
rsource "nanovg/Kconfig"
endmenu

menu "OpenGL ES"
rsource "opengles/Kconfig"
endmenu

menu "SDL"
rsource "sdl/Kconfig"
endmenu
endmenu
```

## src/draw/dma2d/Kconfig
```kconfig
config LV_USE_DRAW_DMA2D
	bool "DMA2D renderer"
	default n
	help
		Accelerate blends, fills and image decoding with the STM32 DMA2D peripheral.

if LV_USE_DRAW_DMA2D

config LV_DRAW_DMA2D_HAL_INCLUDE
	string "STM32 HAL header"
	default "stm32h7xx_hal.h"
	help
		Header that declares the DMA2D HAL API of the target STM32 family.

endif
```

## src/draw/espressif/ppa/Kconfig
```kconfig
config LV_USE_PPA
	bool "PPA renderer"
	default n
	help
		Accelerate blends, fills and transforms with the PPA (Pixel Processing
		Accelerator) peripheral of Espressif SoCs.

if LV_USE_PPA

config LV_USE_PPA_IMG
	bool "Image drawing"
	default n
	help
		Let the PPA also draw images. Only simple cases qualify: unscaled,
		unrotated, fully opaque and without masks.

choice
	prompt "PPA burst length (bytes)"
	default LV_PPA_BURST_LENGTH_128
	help
		DMA burst length used by the PPA clients.

	config LV_PPA_BURST_LENGTH_8
		bool "8"
	config LV_PPA_BURST_LENGTH_16
		bool "16"
	config LV_PPA_BURST_LENGTH_32
		bool "32"
	config LV_PPA_BURST_LENGTH_64
		bool "64"
	config LV_PPA_BURST_LENGTH_128
		bool "128"
endchoice

config LV_PPA_BURST_LENGTH
	int
	default 8 if LV_PPA_BURST_LENGTH_8
	default 16 if LV_PPA_BURST_LENGTH_16
	default 32 if LV_PPA_BURST_LENGTH_32
	default 64 if LV_PPA_BURST_LENGTH_64
	default 128 if LV_PPA_BURST_LENGTH_128
endif
```
